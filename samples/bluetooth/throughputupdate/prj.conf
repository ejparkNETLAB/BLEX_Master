## prj.conf
```kconfig
CONFIG_BT=y
CONFIG_BT_DEBUG_LOG=y
CONFIG_BT_CENTRAL=y
CONFIG_BT_SMP=y
CONFIG_BT_GATT_CLIENT=y
CONFIG_LOG=y
CONFIG_SERIAL=y

CONFIG_ENTROPY_GENERATOR=y
CONFIG_TEST_RANDOM_GENERATOR=y


CONFIG_CONSOLE_SUBSYS=y
CONFIG_CONSOLE_HANDLER=y
CONFIG_CONSOLE_GETCHAR=y

CONFIG_BT_DEVICE_NAME="Nordic_Throughput"
CONFIG_BT_SMP=y
CONFIG_BT_MAX_CONN=2
CONFIG_BT_CTLR_LLCP_CONN=2
CONFIG_ASSERT=n


CONFIG_HEAP_MEM_POOL_SIZE=2048

CONFIG_BT_RX_BUF_LEN=258
CONFIG_BT_GATT_CLIENT=y
CONFIG_BT_ATT_TX_MAX=10
CONFIG_BT_ATT_PREPARE_COUNT=2
CONFIG_BT_CONN_TX_MAX=10
CONFIG_BT_L2CAP_TX_BUF_COUNT=10
CONFIG_BT_L2CAP_DYNAMIC_CHANNEL=y
CONFIG_BT_CTLR_PHY_2M=n
CONFIG_BT_CTLR_RX_BUFFERS=2
CONFIG_BT_CTLR_TX_BUFFERS=10
CONFIG_BT_CTLR_TX_BUFFER_SIZE=251
CONFIG_BT_CTLR_ADVANCED_FEATURES=y
CONFIG_BT_CTLR_XTAL_THRESHOLD=500000
CONFIG_BT_CTLR_CONN_PARAM_REQ=y
CONFIG_BT_CTLR_SCHED_ADVANCED=n
CONFIG_BT_CTLR_XTAL_ADVANCED=n
CONFIG_BT_GATT_READ_MULTIPLE=y
CONFIG_INIT_STACKS=y
CONFIG_THREAD_STACK_INFO=y
CONFIG_MAIN_STACK_SIZE=2048
CONFIG_SYSTEM_WORKQUEUE_STACK_SIZE=4096
CONFIG_BT_RX_STACK_SIZE=4096
CONFIG_BT_CTLR_RX_PRIO_STACK_SIZE=4096
CONFIG_BT_L2CAP_TX_MTU=247
CONFIG_BT_L2CAP_RX_MTU=247
CONFIG_BT_CTLR_DATA_LENGTH_MAX=251
CONFIG_BT_HCI_ACL_FLOW_CONTROL=y
```

## src/main.c
```c
/*
 * Copyright (c) 2018 Nordic Semiconductor ASA
 *
 * SPDX-License-Identifier: LicenseRef-BSD-5-Clause-Nordic
 * In order to evaluate the performance of BLEX, it is a throughput measurement code that was modified and brought from Nordic SDK. 
 * In addition, it was modified so that several slaves can connect to one master.
 * In particular, this code accepts up to two slaves using the same connection interval from the master's point of view, 
 *      and changes the traffic sent to each slave according to time.
 */

#include <kernel.h>
#include <console/console.h>
#include <sys/printk.h>
#include <string.h>
#include <stdlib.h>
#include <zephyr/types.h>

#include <stddef.h>
#include <errno.h>
#include <zephyr.h>

#include <bluetooth/bluetooth.h>
#include <bluetooth/crypto.h>
#include <bluetooth/conn.h>
#include <bluetooth/gatt.h>
#include <bluetooth/hci.h>
#include <bluetooth/uuid.h>
#include "gatt_dm.h"
#include "throughput.h"

#define DEVICE_NAME	CONFIG_BT_DEVICE_NAME
#define DEVICE_NAME_LEN (sizeof(DEVICE_NAME) - 1)

static volatile bool test_ready = true;
static volatile bool nodes_ready = false;
static struct bt_conn *default_conn[CONFIG_BT_MAX_CONN];
static bool scan_start = false;

static struct bt_gatt_throughput gatt_throughput[CONFIG_BT_MAX_CONN];
static struct bt_gatt_exchange_params exchange_params;
int cnt = 0;
int M = 10;
int old_cnt = 0;
int iter_cnt = 2;
int iter = 0;	
bool start_flag = false;
#define sys_le16_to_cpu(val)(val)
static const char img[][81] = {
#include "img.file"
};

static void exchange_func(struct bt_conn *conn, uint8_t att_err,
		struct bt_gatt_exchange_params *params)
{
	struct bt_conn_info info = {0};
	int err;


	err = bt_conn_get_info(conn, &info);
	if (err){
		
		return;
	}

	if (info.role == BT_CONN_ROLE_MASTER){ 
		k_sleep(K_SECONDS(15));
		if(iter == iter_cnt)
			nodes_ready = true;;
		iter++;
		scan_start= false;
		int i;
	}
}

static void discovery_complete(struct bt_gatt_dm *dm,
		void *context)
{
	int err;
	struct bt_gatt_throughput *throughput = context;

	bt_gatt_dm_data_print(dm);
	bt_gatt_throughput_handles_assign(dm, throughput);
	bt_gatt_dm_data_release(dm);


	exchange_params.func = exchange_func;
	err = bt_gatt_exchange_mtu(bt_gatt_dm_conn_get(dm), &exchange_params);
	if (err) {
	} else {
	}
}

static void discovery_service_not_found(struct bt_conn *conn,
		void *context)
{
}

static void discovery_error(struct bt_conn *conn,
		int err,
		void *context)
{
}

struct bt_gatt_dm_cb discovery_cb = {
	.completed         = discovery_complete,
	.service_not_found = discovery_service_not_found,
	.error_found       = discovery_error,
};

static uint8_t throughput_read(struct bt_conn *conn, const struct bt_gatt_throughput_metrics *met)
{
	int i;
	for(i = 0; i <CONFIG_BT_MAX_CONN; i ++)
		if(default_conn[i] == conn){
			printk("\n[peer]round %u: received %u bytes (%u KB)"
				" in %u GATT writes at %u bps from slave %u\n",cnt,
				met->write_len, met->write_len / 1024, met->write_count,
				met->write_rate, i);
			i = CONFIG_BT_MAX_CONN;
		}
		test_ready = true;

	return BT_GATT_ITER_STOP;
}
static void throughput_received(const struct bt_gatt_throughput_metrics *met)
{
	static uint32_t kb;

	if (met->write_len == 0) {
		kb = 0;

		return;
	}

	if ((met->write_len / 1024) != kb) {
		kb = (met->write_len / 1024);
	}
}
static void throughput_send(const struct bt_gatt_throughput_metrics *met)
{
}
static const struct bt_gatt_throughput_cb throughput_cb = {
	.data_read = throughput_read,
	.data_received = throughput_received,
	.data_send = throughput_send
};
static void connected(struct bt_conn *conn, uint8_t hci_err)
{
	struct bt_conn_info info = {0};
	int err;
	err = bt_conn_get_info(conn, &info);
	if (err) {
		return;
	}


	char addr[BT_ADDR_LE_STR_LEN];

	bt_addr_le_to_str(bt_conn_get_dst(conn), addr, sizeof(addr));

	if (hci_err) {
		for(int i = 0; i < CONFIG_BT_MAX_CONN; i ++)
			if(default_conn[i] == conn){
				bt_conn_unref(default_conn[i]);
				default_conn[i] = NULL;
				start_scan();
			}

		return;
	}
	printk("[peer] Conn. interval is %u units\n", info.le.interval);
	int i;
	for( i = 0; i <CONFIG_BT_MAX_CONN; i ++)
		if(default_conn[i] == conn) {
			err = bt_gatt_dm_start(default_conn[i],
					BT_UUID_THROUGHPUT,
					&discovery_cb,
					&gatt_throughput[i]);
			if (err) {
			}
			i = CONFIG_BT_MAX_CONN;
		}
}
static bool eir_found(struct bt_data *data, void *user_data)
{
	bt_addr_le_t *addr = user_data;
	int i;


	switch (data->type) {
		case BT_DATA_UUID16_SOME:
		case BT_DATA_UUID16_ALL:
			if (data->data_len % sizeof(uint16_t) != 0U) {
				return true;
			}

			for (i = 0; i < data->data_len; i += sizeof(uint16_t)) {
				struct bt_le_conn_param *param, *param2;
				struct bt_uuid *uuid;
				uint16_t u16;
				int err;

				memcpy(&u16, &data->data[i], sizeof(u16));
				uuid = BT_UUID_DECLARE_16(sys_le16_to_cpu(u16));
				if (bt_uuid_cmp(uuid, BT_UUID_HRS)) {
					continue;
				}

				param = BT_LE_CONN_PARAM_DEFAULT;
				param2 = BT_LE_CONN_PARAM_DEFAULT2;
				int number= 0;
				for(int i = 0; i <CONFIG_BT_MAX_CONN && number<iter+1 && iter<iter_cnt; i ++){
					if(default_conn[i] == NULL){
						err = bt_le_scan_stop();
						if (err) {
							continue;
						}
						scan_start = false;
						err = bt_conn_le_create(addr, BT_CONN_LE_CREATE_CONN,
								param, &default_conn[i]);
						if (err) {
						}
						i = CONFIG_BT_MAX_CONN;
					}else{
						 number ++;
					}
				}

				return false;
			}
	}

	return true;
}

static void device_found(const bt_addr_le_t *addr, uint8_t rssi, uint8_t type,
		struct net_buf_simple *ad)
{
	char dev[BT_ADDR_LE_STR_LEN];

	bt_addr_le_to_str(addr, dev, sizeof(dev));

	/* We're only interested in connectable events */
	if (type == BT_GAP_ADV_TYPE_ADV_IND ||
			type == BT_GAP_ADV_TYPE_ADV_DIRECT_IND) {
		bt_data_parse(ad, eir_found, (void *)addr);

	}
}


void start_scan(void)
{

	int err;
	nodes_ready = false;
	scan_start= true;
	/* Use active scanning and disable duplicate filtering to handle any
	 * devices that might update their advertising data at runtime. */
	struct bt_le_scan_param scan_param = {
		.type       = BT_LE_SCAN_TYPE_ACTIVE,
		.options    = BT_LE_SCAN_OPT_NONE,
		.interval   = BT_GAP_SCAN_FAST_INTERVAL,
		.window     = BT_GAP_SCAN_FAST_WINDOW,
	};

	err = bt_le_scan_start(&scan_param, device_found);
	if (err) {
		return;
	}

	printk("[peer]Scanning successfully started\n");
}
static void disconnected(struct bt_conn *conn, uint8_t reason)
{
	struct bt_conn_info info = {0};
	int err;

	for(int i = 0; i<CONFIG_BT_MAX_CONN; i ++)
		if(conn == default_conn[i]){
			printk("[peer]disconnected\n");
			bt_conn_unref(conn);
			default_conn[i] = NULL;
			cnt = 0;
			iter -= 1;
			i = CONFIG_BT_MAX_CONN;
		}
	err = bt_conn_get_info(conn, &info);
	if (err) {
		return;
	}

	/* Re-connect using same roles */
	if (info.role == BT_CONN_ROLE_MASTER) {
		start_scan();
	}
}

static void test_run(void)
{
	int err;
	uint64_t stamp;
	uint32_t delta;
	uint32_t data=0;
	uint32_t prog=0;

	/* a dummy data buffer */
	static char dummy[256];//ejpark0401

	/* wait for user input to continue */

	int number;
	number = 0;
	for(int i = 0; i<CONFIG_BT_MAX_CONN; i ++ )
		if( default_conn[i] !=NULL){
			number ++;
		}
	if(iter<iter_cnt|| !test_ready ){
		if(scan_start == false) start_scan();
		return;
	}


	/* reset peer metrics */
	number = 0;
	for(int i =0; i <CONFIG_BT_MAX_CONN && number < iter_cnt;i++ ){
		if(default_conn[i] != NULL){
			struct bt_conn *temp_conn = gatt_throughput[i].conn;
			err = bt_gatt_throughput_write(&gatt_throughput[i], dummy, 1);
			number ++;
		}
	}
	if (err) {
		return;
	}
	int sec = 15000/iter;
	int temp_iter = iter;
	stamp= k_uptime_get_32();
	int break_time = 2;
	uint64_t stamp2;
	while(k_uptime_get_32()-stamp < 20000){
		number = 0;
	stamp2 = k_uptime_get_32();		
		for(int i =0; i <CONFIG_BT_MAX_CONN && number < temp_iter;i++ ){
			if(default_conn[i] != NULL){
				/* BLEX: By changing the data length, we can change the amount of traffic of each slaves*/
				if((i+cnt)%2 == 0)
					err = bt_gatt_throughput_write(&gatt_throughput[i], dummy, 240);
				else 
					err = bt_gatt_throughput_write(&gatt_throughput[i], dummy, 80);
				number ++;
			}
		}
		while(k_uptime_get_32()-stamp2 <break_time);
		prog ++;
		data += 340;
		if (err) {
			break;
		}
	}

	delta = k_uptime_get_32()-stamp;
	printk("\n[ejpark2]Done\n");
		printk("[ejpark2][local] round %d: sent %u bytes (%u KB) in %u ms at %llu kbps\n",cnt,
				data, data / 1024, delta, ((uint64_t)data* 8 / delta));
	/* read back char from peer */
	number = 0;
	for(int i =0; i <CONFIG_BT_MAX_CONN && number < iter;i++ ){
		if(default_conn[i] != NULL){
			err = bt_gatt_throughput_read(&gatt_throughput[i]);
			test_ready = false;
			number ++;
		}
	}
	if (err) {
	}
	start_flag = true;
	cnt ++;
}

static bool le_param_req(struct bt_conn *conn, struct bt_le_conn_param *param)
{
	/* reject peer conn param request */
	return false;
}

void main(void)
{
	int err;

	static struct bt_conn_cb conn_callbacks = {
		.connected = connected,
		.disconnected = disconnected,
		.le_param_req = le_param_req,
	};

	bt_conn_cb_register(&conn_callbacks);

	err = bt_enable(NULL);
	if (err) {
		return;
	}
	for(int i = 0; i<CONFIG_BT_MAX_CONN; i ++){
		default_conn[i] = NULL;
	}

	for(int i = 0; i <CONFIG_BT_MAX_CONN; i ++){
		err = bt_gatt_throughput_init(&gatt_throughput[i], &throughput_cb);
	}
	
	start_scan();
	
	if (err) {
		return;
	}
	test_ready = true;

	for ( ;;) {
		test_run();
	}

}
```

## src/gatt_dm.c
```c
/*
 * Copyright (c) 2018 Nordic Semiconductor ASA
 *
 * SPDX-License-Identifier: LicenseRef-BSD-5-Clause-Nordic
 */

#include <inttypes.h>
#include <zephyr.h>
#include <logging/log.h>
#include <bluetooth/conn.h>
#include <bluetooth/bluetooth.h>
#include <bluetooth/crypto.h>
#include <bluetooth/gatt.h>
#include <bluetooth/hci.h>
#include <bluetooth/uuid.h>

#include "gatt_dm.h"

LOG_MODULE_REGISTER(bt_gatt_dm, LOG_LEVEL_DBG);

/* Available sizes: 128, 512, 2048... */
#define CHUNK_DATA_SIZE (128 - sizeof(struct k_mem_block_id) \
		- sizeof(struct data_chunk_item *))

#define DATA_ALIGN 4U

#define CONFIG_BT_GATT_DM_MAX_ATTRS 35
/* They are placed in data_chunk without padding, so they must be aligned */
BUILD_ASSERT(sizeof(struct bt_gatt_service_val) % DATA_ALIGN == 0);
BUILD_ASSERT(sizeof(struct bt_gatt_chrc) % DATA_ALIGN == 0);

/* Flags for parsed attribute array state */
enum {
	STATE_ATTRS_LOCKED,
	STATE_ATTRS_RELEASE_PENDING,
	STATE_NUM
};

/* One item in linked list containing dynamically allocated user data chunks */
struct data_chunk_item {
	/* Required by the sys_slist */
	sys_snode_t node;
	/* User data storage */
	uint8_t data[CHUNK_DATA_SIZE];
};

/* The instance structure real declaration */
struct bt_gatt_dm {
	/* Connection object */
	struct bt_conn *conn;
	/* The user context */
	void *context;

	/* The discovery parameters used */
	struct bt_gatt_discover_params discover_params;
	/* Currently parsed attributes */
	struct bt_gatt_dm_attr attrs[CONFIG_BT_GATT_DM_MAX_ATTRS];
	/* Currently accessed attribute */
	size_t cur_attr_id;
	/* Flags with the status of the attributes */
	ATOMIC_DEFINE(state_flags, STATE_NUM);

	/* Single-linked list of allocated chunks for user data */
	sys_slist_t chunk_list;
	/* The used length of the current chunk */
	size_t cur_chunk_len;

	/* The pointer to callback structure */
	const struct bt_gatt_dm_cb *callback;
};

/* Currently only one instance is supported */
static struct bt_gatt_dm bt_gatt_dm_inst[CONFIG_BT_MAX_CONN];

/* Returns pointer to newly allocated space in a dm->data_chunk */
static void *user_data_alloc(struct bt_gatt_dm *dm,
			     size_t len)
{
	uint8_t *user_data_loc;
	struct data_chunk_item *item;

	/* Round up len to 32 bits to make sure that return pointers are always
	 * correctly aligned.
	 */
	len = (len + DATA_ALIGN - 1) & ~(DATA_ALIGN - 1);

	__ASSERT_NO_MSG(len <= CHUNK_DATA_SIZE);

	if (sys_slist_is_empty(&dm->chunk_list) ||
	    dm->cur_chunk_len + len > CHUNK_DATA_SIZE) {

		item = k_malloc(sizeof(struct data_chunk_item));

		if (!item) {
			return NULL;
		}

		sys_slist_append(&dm->chunk_list, &item->node);
		dm->cur_chunk_len = 0;

	} else {

		item = SYS_SLIST_PEEK_TAIL_CONTAINER(&dm->chunk_list, item,
						     node);

	}

	user_data_loc = &item->data[dm->cur_chunk_len];
	dm->cur_chunk_len += len;

	return user_data_loc;
}

static void svc_attr_memory_release(struct bt_gatt_dm *dm)
{
	sys_snode_t *node;
	struct data_chunk_item *item;

	LOG_DBG("Attr memory release");

	/* Clear attributes */
	dm->cur_attr_id = 0;

	/* Release dynamic memory data chunks */
	while (!sys_slist_is_empty(&dm->chunk_list)) {
		node = sys_slist_get_not_empty(&dm->chunk_list);
		item = CONTAINER_OF(node, struct data_chunk_item, node);
		k_free(item);
	}

	dm->cur_chunk_len = 0;
}

/* Returns size of UUID structure with padding for memory alignment */
static size_t get_uuid_size(const struct bt_uuid *uuid)
{
	switch (uuid->type) {
	case BT_UUID_TYPE_16:
		return sizeof(struct bt_uuid_16);
	case BT_UUID_TYPE_32:
		return sizeof(struct bt_uuid_32);
	case BT_UUID_TYPE_128:
		return sizeof(struct bt_uuid_128);
	default:
		LOG_ERR("Unsupported UUID type.");
		return 0;
	}
}

/** @brief Stores attribute in bt_gatt_dm instance.
 *
 * This function stores attr at dm->attrs array. Its UUID is stored in
 * dm->data_chunk. The Discovery Manager attribute does not contain
 * a pointer to the context data. This data could be either
 * bt_gatt_service_val or bt_gatt_chrc. It is assumed that attribute context
 * data (if any) is always placed before its UUID data. For this purpose,
 * an additional buffer is allocated by this function and used later.
 *
 * @param[in] dm             Discovery instance
 * @param[in] attr           Service attribute
 * @param[in] additional_len Additional buffer length
 *
 * @return Pointer to newly stored attribute.
 */
static struct bt_gatt_dm_attr *attr_store(struct bt_gatt_dm *dm,
					  const struct bt_gatt_attr *attr,
					  size_t additional_len)
{
	struct bt_gatt_dm_attr *cur_attr;

	//printk("[ejpark3] Attr store, pos: %zu, handle: %"PRIu16,
//		dm->cur_attr_id,
//		attr->handle);
	LOG_DBG("Attr store, pos: %zu, handle: %"PRIu16,
		dm->cur_attr_id,
		attr->handle);
	if (dm->cur_attr_id >= ARRAY_SIZE(dm->attrs)) {
		LOG_ERR("No space for new attribute.");
		return NULL;
	}

	size_t uuid_size = get_uuid_size(attr->uuid);
	uint8_t *attr_data = user_data_alloc(dm, additional_len + uuid_size);

	if (!attr_data) {
		LOG_ERR("No space for attribute data.");
		return NULL;
	}

	cur_attr = &dm->attrs[(dm->cur_attr_id)++];
	cur_attr->handle = attr->handle;
	cur_attr->perm = attr->perm;
	cur_attr->uuid = (struct bt_uuid *)&attr_data[additional_len];

	memcpy(cur_attr->uuid, attr->uuid, uuid_size);

	return cur_attr;
}

static struct bt_uuid *uuid_store(struct bt_gatt_dm *dm,
				  const struct bt_uuid *uuid)
{
	if (!uuid) {
		LOG_ERR("Uninitialized UUID.");
		return NULL;
	}

	size_t size = get_uuid_size(uuid);
	void *buffer = user_data_alloc(dm, size);

	memcpy(buffer, uuid, size);

	return (struct bt_uuid *)buffer;
}

static struct bt_gatt_dm_attr *attr_find_by_handle(
	struct bt_gatt_dm *dm,
	uint16_t handle)
{
	if (!dm->cur_attr_id) {
		return NULL;
	}

	ssize_t lower = 0;
	ssize_t upper = dm->cur_attr_id - 1;

	while (upper >= lower) {
		size_t m = (lower + upper) / 2;
		struct bt_gatt_dm_attr *cur_attr = &dm->attrs[m];

		if (cur_attr->handle < handle) {
			lower = m + 1;
		} else if (cur_attr->handle > handle) {
			upper = m - 1;
		} else {
			return cur_attr;
		}
	}

	/* handle not found */
	return NULL;
}

static void discovery_complete(struct bt_gatt_dm *dm)
{
	LOG_DBG("Discovery complete.");
	atomic_set_bit(dm->state_flags, STATE_ATTRS_RELEASE_PENDING);
	if (dm->callback->completed) {
		dm->callback->completed(dm, dm->context);
	}
}

static void discovery_complete_not_found(struct bt_gatt_dm *dm)
{
	LOG_DBG("Discover complete. No service found.");

	svc_attr_memory_release(dm);
	atomic_clear_bit(dm->state_flags, STATE_ATTRS_LOCKED);

	if (dm->callback->service_not_found) {
		dm->callback->service_not_found(dm->conn, dm->context);
	}
}

static void discovery_complete_error(struct bt_gatt_dm *dm, int err)
{
	svc_attr_memory_release(dm);
	atomic_clear_bit(dm->state_flags, STATE_ATTRS_LOCKED);
	if (dm->callback->error_found) {
		dm->callback->error_found(dm->conn, err, dm->context);
	}
}

static uint8_t discovery_process_service(struct bt_gatt_dm *dm,
				      const struct bt_gatt_attr *attr,
				      struct bt_gatt_discover_params *params)
{
	int err;

	if (!attr) {
		discovery_complete_not_found(dm);
		//printk("[ejpark] discovery_process_service stop\n");
		return BT_GATT_ITER_STOP;
	}

	struct bt_gatt_service_val *service_val = attr->user_data;
	struct bt_gatt_dm_attr *cur_attr =
		attr_store(dm, attr, sizeof(*service_val));

	__ASSERT_NO_MSG(bt_uuid_cmp(attr->uuid, BT_UUID_GATT_PRIMARY) == 0 ||
			bt_uuid_cmp(attr->uuid, BT_UUID_GATT_SECONDARY) == 0);

	if (!cur_attr) {
		//printk("[ejpark2]Not enough memory for service attribute.");
		LOG_ERR("[ejpark2]Not enough memory for service attribute.");
		discovery_complete_error(dm, -ENOMEM);
		return BT_GATT_ITER_STOP;
	}

	//printk("[ejpark2]Service detected, handles range: <%u, %u>",
		//cur_attr->handle + 1,
		//service_val->end_handle);
	LOG_DBG("[ejpark2]Service detected, handles range: <%u, %u>",
		cur_attr->handle + 1,
		service_val->end_handle);

	struct bt_gatt_service_val *cur_service_val =
		bt_gatt_dm_attr_service_val(cur_attr);
	memcpy(cur_service_val, service_val, sizeof(*cur_service_val));

	cur_service_val->uuid = uuid_store(dm, cur_service_val->uuid);

	if (!cur_service_val->uuid) {
		LOG_ERR("[ejpark2]Not enough memory for service attribute data.");
		discovery_complete_error(dm, -ENOMEM);
		return BT_GATT_ITER_STOP;
	}

	dm->discover_params.uuid         = NULL;
	dm->discover_params.type         = BT_GATT_DISCOVER_ATTRIBUTE;
	dm->discover_params.start_handle = cur_attr->handle + 1;//here
	dm->discover_params.end_handle   = cur_service_val->end_handle;
	LOG_DBG("[ejpark2]Starting descriptors discovery");
	//printk("[ejpark2]Starting descriptors discovery");
	err = bt_gatt_discover(dm->conn, &(dm->discover_params));

	if (err) {
		LOG_ERR("[ejpark2]Descriptor discover failed, error: %d.", err);
		//printk("[ejpark2]Descriptor discover failed, error: %d.", err);
		discovery_complete_error(dm, -ENOMEM);
		return BT_GATT_ITER_STOP;
	}

	//printk("[ejpark2] well done!\n");
	return BT_GATT_ITER_STOP;
}

static uint8_t discovery_process_attribute(struct bt_gatt_dm *dm,
					 const struct bt_gatt_attr *attr,
					 struct bt_gatt_discover_params *params)
{
	struct bt_gatt_dm_attr *cur_attr;

	if (!attr) {
		if (dm->cur_attr_id > 1) {
			LOG_DBG("Starting characteristic discovery");
			dm->discover_params.start_handle =
				dm->attrs[0].handle + 1;
			dm->discover_params.type =
				BT_GATT_DISCOVER_CHARACTERISTIC;
			int err = bt_gatt_discover(dm->conn,
						   &(dm->discover_params));

			if (err) {
				LOG_ERR("Characteristic discover failed,"
					" error: %d.",
					err);
				discovery_complete_error(dm, err);
			}
		} else {
			discovery_complete(dm);
		}
		return BT_GATT_ITER_STOP;
	}

	if (bt_uuid_cmp(attr->uuid, BT_UUID_GATT_CHRC) == 0) {
		cur_attr = attr_store(dm, attr, sizeof(struct bt_gatt_chrc));
	} else {
		cur_attr = attr_store(dm, attr, 0);
	}

	if (!cur_attr) {
		LOG_ERR("Not enough memory for next attribute descriptor"
			" at handle %u.",
			attr->handle);
		discovery_complete_error(dm, -ENOMEM);
		return BT_GATT_ITER_STOP;
	}

	return BT_GATT_ITER_CONTINUE;
}

static uint8_t discovery_process_characteristic(
		struct bt_gatt_dm *dm,
		const struct bt_gatt_attr *attr,
		struct bt_gatt_discover_params *params)
{
	struct bt_gatt_chrc *gatt_chrc;
	struct bt_gatt_dm_attr *cur_attr;
	struct bt_gatt_chrc *cur_gatt_chrc;

	if (!attr) {
		discovery_complete(dm);
		return BT_GATT_ITER_STOP;
	}

//printk("[ejpark2] 31\n");
	__ASSERT_NO_MSG(bt_uuid_cmp(attr->uuid, BT_UUID_GATT_CHRC) == 0);
//printk("[ejpark2]32\n");

	cur_attr = attr_find_by_handle(dm, attr->handle);
	if (!cur_attr) {
		/* We should never be here is the server is working properly */
		discovery_complete_error(dm, -ESRCH);
		return BT_GATT_ITER_STOP;
	}

	//printk("[ejpark2]33\n");
	gatt_chrc = attr->user_data;
	cur_gatt_chrc = bt_gatt_dm_attr_chrc_val(cur_attr);
	memcpy(cur_gatt_chrc, gatt_chrc, sizeof(*cur_gatt_chrc));
	cur_gatt_chrc->uuid = uuid_store(dm, cur_gatt_chrc->uuid);
	//printk("[ejpark2]34\n");
	if (!cur_gatt_chrc->uuid) {
		discovery_complete_error(dm, -ENOMEM);
		return BT_GATT_ITER_STOP;
	}

	return BT_GATT_ITER_CONTINUE;
}

static uint8_t discovery_callback(struct bt_conn *conn,
			       const struct bt_gatt_attr *attr,
			       struct bt_gatt_discover_params *params)
{
	if (!attr) {
		LOG_DBG("NULL attribute");
	} else {
		LOG_DBG("Attr: handle %u", attr->handle);
	}
	//printk("[ejpark2] discovery_callback\n");
	bool flag_ej = false;
	int i;
	for(i = 0; i <CONFIG_BT_MAX_CONN && flag_ej == false;)
		if (conn == bt_gatt_dm_inst[i].conn) {
			flag_ej = true;
			//printk("[ejpark] i = %u\n",i );
		}
		else i ++;
	if(!flag_ej){
		LOG_ERR("Unexpected conn object. Aborting.");
		//printk("[ejpark2] error!\n");

		return BT_GATT_ITER_STOP;
	}
	switch (params->type) {
	case BT_GATT_DISCOVER_PRIMARY:
	case BT_GATT_DISCOVER_SECONDARY:
		//printk("[ejpark2] 1\n");
		return discovery_process_service(&(bt_gatt_dm_inst[i]),
						 attr, params);
	case BT_GATT_DISCOVER_ATTRIBUTE:
		//printk("[ejpark2] 2\n");
		return discovery_process_attribute(&(bt_gatt_dm_inst[i]),
						   attr, params);
	case BT_GATT_DISCOVER_CHARACTERISTIC:
		//printk("[ejpark2] 3\n");
		return discovery_process_characteristic(&(bt_gatt_dm_inst[i]),
							attr,
							params);
	default:
		/* This should not be possible */
		//printk("[ejpark2] 4\n");
		__ASSERT(false, "Unknown param type.");
		break;
	}

	return BT_GATT_ITER_STOP;
}

struct bt_gatt_service_val *bt_gatt_dm_attr_service_val(
	const struct bt_gatt_dm_attr *attr)
{
	if ((!bt_uuid_cmp(BT_UUID_GATT_PRIMARY, attr->uuid)) ||
	    (!bt_uuid_cmp(BT_UUID_GATT_SECONDARY, attr->uuid))) {
		return &((struct bt_gatt_service_val *)attr->uuid)[-1];
	}
	return NULL;
}

struct bt_gatt_chrc *bt_gatt_dm_attr_chrc_val(
	const struct bt_gatt_dm_attr *attr)
{
	if (!bt_uuid_cmp(BT_UUID_GATT_CHRC, attr->uuid)) {
		return &((struct bt_gatt_chrc *)attr->uuid)[-1];
	}
	return NULL;
}

struct bt_conn *bt_gatt_dm_conn_get(struct bt_gatt_dm *dm)
{
	return dm->conn;
}

size_t bt_gatt_dm_attr_cnt(const struct bt_gatt_dm *dm)
{
	return dm->cur_attr_id;
}

const struct bt_gatt_dm_attr *bt_gatt_dm_service_get(
	const struct bt_gatt_dm *dm)
{
	return &(dm->attrs[0]);
}

const struct bt_gatt_dm_attr *bt_gatt_dm_char_next(
	const struct bt_gatt_dm *dm,
	const struct bt_gatt_dm_attr *prev)
{
	if (!prev) {
		prev = dm->attrs;
	}

	if (dm->attrs <= prev) {
		const struct bt_gatt_dm_attr *const end =
			&(dm->attrs[dm->cur_attr_id]);
		while (++prev < end) {
			if (!bt_uuid_cmp(BT_UUID_GATT_CHRC, prev->uuid)) {
				return prev;
			}
		}
	}

	return NULL;
}

const struct bt_gatt_dm_attr *bt_gatt_dm_char_by_uuid(
	const struct bt_gatt_dm *dm,
	const struct bt_uuid *uuid)
{
	const struct bt_gatt_dm_attr *curr = NULL;

	while ((curr = bt_gatt_dm_char_next(dm, curr)) != NULL) {
		struct bt_gatt_chrc *chrc = bt_gatt_dm_attr_chrc_val(curr);

		__ASSERT_NO_MSG(chrc != NULL);
		if (!bt_uuid_cmp(uuid, chrc->uuid)) {
			return curr;
		}
	}

	return NULL;
}

const struct bt_gatt_dm_attr *bt_gatt_dm_attr_by_handle(
	const struct bt_gatt_dm *dm,
	uint16_t handle)
{
	return attr_find_by_handle((struct bt_gatt_dm *)dm, handle);
}

const struct bt_gatt_dm_attr *bt_gatt_dm_attr_next(
	const struct bt_gatt_dm *dm,
	const struct bt_gatt_dm_attr *prev)
{
	if (!prev) {
		prev = dm->attrs;
	}

	if (dm->attrs <= prev) {
		const struct bt_gatt_dm_attr *const end =
			&(dm->attrs[dm->cur_attr_id]);
		if (++prev < end) {
			return prev;
		}
	}

	return NULL;
}

const struct bt_gatt_dm_attr *bt_gatt_dm_desc_by_uuid(
	const struct bt_gatt_dm *dm,
	const struct bt_gatt_dm_attr *attr_chrc,
	const struct bt_uuid *uuid)
{
	const struct bt_gatt_dm_attr *curr = attr_chrc;

	while ((curr = bt_gatt_dm_desc_next(dm, curr)) != NULL) {
		if (!bt_uuid_cmp(uuid, curr->uuid)) {
			break;
		}
	}

	return curr;
}

const struct bt_gatt_dm_attr *bt_gatt_dm_desc_next(
	const struct bt_gatt_dm *dm,
	const struct bt_gatt_dm_attr *prev)
{
	const struct bt_gatt_dm_attr *curr = bt_gatt_dm_attr_next(dm, prev);

	if (curr && !bt_uuid_cmp(BT_UUID_GATT_CHRC, curr->uuid)) {
		curr = NULL;
	}

	return curr;
}

int bt_gatt_dm_start(struct bt_conn *conn,
		     const struct bt_uuid *svc_uuid,
		     const struct bt_gatt_dm_cb *cb,
		     void *context)
{
	int err;
	struct bt_gatt_dm *dm;
	if (svc_uuid &&
	    (svc_uuid->type != BT_UUID_TYPE_16) &&
	    (svc_uuid->type != BT_UUID_TYPE_128)) {
		return -EINVAL;
	}

	if (!cb) {
		return -EINVAL;
	}
	int i;
	for(i = 0; i < CONFIG_BT_MAX_CONN; i ++){
		if(conn == bt_conn_lookup_handle(i)) {
			dm = &bt_gatt_dm_inst[i];
//printk("[ejpark2] i = %u \n", i);
		}
	}

	if (atomic_test_and_set_bit(dm->state_flags, STATE_ATTRS_LOCKED)) {
		return -EALREADY;
	}

	dm->conn = conn;
	dm->context = context;
	dm->callback = cb;
	dm->cur_attr_id = 0;
	sys_slist_init(&dm->chunk_list);
	dm->cur_chunk_len = 0;

	dm->discover_params.uuid = svc_uuid ? uuid_store(dm, svc_uuid) : NULL;
	dm->discover_params.func = discovery_callback;

		
	dm->discover_params.start_handle = 0x0001;//+0xffff/CONFIG_BT_MAX_CONN*i;
	dm->discover_params.end_handle = 0xffff;//CONFIG_BT_MAX_CONN*(i+1);
	
	dm->discover_params.type = BT_GATT_DISCOVER_PRIMARY;

	err = bt_gatt_discover(conn, &dm->discover_params);
	
	if (err) {
		LOG_ERR("[ejpark2]Discover failed, error: %d.", err);
		atomic_clear_bit(dm->state_flags, STATE_ATTRS_LOCKED);
	}

//printk("[ejpark2] bt_gatt_dm_start4\n");
	return err;
}

int bt_gatt_dm_continue(struct bt_gatt_dm *dm, void *context)
{
	int err;

	if ((!dm) ||
	    (!dm->callback) ||
	    (dm->discover_params.func != discovery_callback)) {
		return -EINVAL;
	}

	/* If UUID is set, it does not make sense to call this function.
	 * The stored UUID would be broken anyway in bt_gatt_dm_data_release.
	 */
	if (dm->discover_params.uuid) {
		return -EINVAL;
	}

	if (atomic_test_and_set_bit(dm->state_flags, STATE_ATTRS_LOCKED)) {
		return -EALREADY;
	}

	if (dm->discover_params.end_handle == 0xffff) {
		/* No more handles to discover. */
		discovery_complete_not_found(dm);
		return 0;
	}

	dm->context = context;
	dm->discover_params.start_handle = dm->discover_params.end_handle + 1;//here
	dm->discover_params.end_handle = 0xffff;
	dm->discover_params.type = BT_GATT_DISCOVER_PRIMARY;

	err = bt_gatt_discover(dm->conn, &dm->discover_params);
	if (err) {
		LOG_ERR("Discover failed, error: %d.", err);
		atomic_clear_bit(dm->state_flags, STATE_ATTRS_LOCKED);
	}

	return err;
}

int bt_gatt_dm_data_release(struct bt_gatt_dm *dm)
{
	if (!atomic_test_and_clear_bit(dm->state_flags,
				       STATE_ATTRS_RELEASE_PENDING)) {
		return -EALREADY;
	}

	svc_attr_memory_release(dm);
	atomic_clear_bit(dm->state_flags, STATE_ATTRS_LOCKED);

	return 0;
}

#if CONFIG_BT_GATT_DM_DATA_PRINT

#define UUID_STR_LEN 37

static void svc_attr_data_print(const struct bt_gatt_service_val *gatt_service)
{
	char str[UUID_STR_LEN];

	bt_uuid_to_str(gatt_service->uuid, str, sizeof(str));
	//printk("[ejpark4]\tService: 0x%s\tEnd Handle: 0x%04X\n",
			str, gatt_service->end_handle);
}

static void chrc_attr_data_print(const struct bt_gatt_chrc *gatt_chrc)
{
	char str[UUID_STR_LEN];

	bt_uuid_to_str(gatt_chrc->uuid, str, sizeof(str));
	////printk("[ejpark4]\tCharacteristic: 0x%s\tProperties: 0x%04X\n",
			str, gatt_chrc->properties);
}

static void attr_print(const struct bt_gatt_dm *dm,
		       const struct bt_gatt_dm_attr *attr)
{
	char str[UUID_STR_LEN];

	bt_uuid_to_str(attr->uuid, str, sizeof(str));
	//printk("[ejpark4] ATT[%u]: \tUUID: 0x%s\tHandle: 0x%04X\tValue:\n",
	       (unsigned int)(attr - dm->attrs), str, attr->handle);

	if ((bt_uuid_cmp(attr->uuid, BT_UUID_GATT_PRIMARY) == 0) ||
	    (bt_uuid_cmp(attr->uuid, BT_UUID_GATT_SECONDARY) == 0)) {
		svc_attr_data_print(bt_gatt_dm_attr_service_val(attr));
	} else if (bt_uuid_cmp(attr->uuid, BT_UUID_GATT_CHRC) == 0) {
		chrc_attr_data_print(bt_gatt_dm_attr_chrc_val(attr));
	} else if (bt_uuid_cmp(attr->uuid, BT_UUID_GATT_CCC) == 0) {
		//printk("\tCCCD\n");
	}
}

void bt_gatt_dm_data_print(const struct bt_gatt_dm *dm)
{
	const struct bt_gatt_dm_attr *attr = NULL;

//printk("[ejpark4] ?????\n");
	while (NULL != (attr = bt_gatt_dm_attr_next(dm, attr))) {
		attr_print(dm, attr);
	}
}

#endif /* CONFIG_BT_GATT_DM_DATA_PRINT */
```

## src/throughput.c
```c
/*
 * Copyright (c) 2018 Nordic Semiconductor ASA
 *
 * SPDX-License-Identifier: LicenseRef-BSD-5-Clause-Nordic
 */

#include <kernel.h>
#include <sys/printk.h>
#include <string.h>
#include <zephyr/types.h>

#include <bluetooth/bluetooth.h>
#include <bluetooth/conn.h>
#include <bluetooth/gatt.h>
#include <bluetooth/hci.h>
#include <bluetooth/uuid.h>

#include "throughput.h"

#include <logging/log.h>

LOG_MODULE_REGISTER(bt_gatt_throughput, LOG_LEVEL_DBG);

static struct bt_gatt_throughput_metrics met;
static const struct bt_gatt_throughput_cb *callbacks;

static uint8_t read_fn(struct bt_conn *conn, uint8_t err,
		    struct bt_gatt_read_params *params, const void *data,
		    uint16_t len)
{
	struct bt_gatt_throughput_metrics metrics;

	memset(&metrics, 0, sizeof(struct bt_gatt_throughput_metrics));

	if (data) {
		len = MIN(len, sizeof(struct bt_gatt_throughput_metrics));
		memcpy(&metrics, data, len);

		if (callbacks->data_read) {
			return callbacks->data_read(conn, &metrics);
		}
	}

	return BT_GATT_ITER_STOP;
}

static ssize_t write_callback(struct bt_conn *conn,
			      const struct bt_gatt_attr *attr, const void *buf,
			      uint16_t len, uint16_t offset, uint8_t flags)
{
	//printk("[peer]write_callback\n");
	static uint32_t clock_cycles;
	static uint32_t kb;

	uint64_t delta;

	struct bt_gatt_throughput_metrics *met_data = attr->user_data;

	delta = k_cycle_get_32() - clock_cycles;
	delta = k_cyc_to_ns_floor64(delta);

	if (len == 1) {
		/* reset metrics */
		kb = 0;
		met_data->write_count = 0;
		met_data->write_len = 0;
		met_data->write_rate = 0;
		clock_cycles = k_cycle_get_32();
	} else {
		met_data->write_count++;
		met_data->write_len += len;
		met_data->write_rate =
		    ((uint64_t)met_data->write_len << 3) * 1000000000 / delta;
	}

	LOG_DBG("Received data.");

	if (callbacks->data_received) {
		callbacks->data_received(met_data);
	}

	return len;
}

static ssize_t read_callback(struct bt_conn *conn,
			     const struct bt_gatt_attr *attr, void *buf,
			     uint16_t len, uint16_t offset)
{
	//printk("[peer]read_callback is called\n");
	const struct bt_gatt_throughput_metrics *metrics = attr->user_data;

	len = MIN(sizeof(struct bt_gatt_throughput_metrics), len);

	if (callbacks->data_send) {
		callbacks->data_send(metrics);
	}

	LOG_DBG("Data send.");

	return bt_gatt_attr_read(
		conn, attr, buf, len, offset, attr->user_data, len);
}


BT_GATT_SERVICE_DEFINE(throughput_svc,
		BT_GATT_PRIMARY_SERVICE(BT_UUID_THROUGHPUT),
		BT_GATT_CHARACTERISTIC(BT_UUID_THROUGHPUT_CHAR,
			BT_GATT_CHRC_READ | BT_GATT_CHRC_WRITE_WITHOUT_RESP,
			BT_GATT_PERM_READ | BT_GATT_PERM_WRITE,
			read_callback, write_callback, &met),
		);

int bt_gatt_throughput_init(struct bt_gatt_throughput *throughput,
			    const struct bt_gatt_throughput_cb *cb)
{
	if (!throughput || !cb) {
		printk("[ejpark] fail!!!!\n");
		return -EINVAL;
	}

	callbacks = cb;

		printk("[ejpark] no fail!!!!\n");
	return 0;
}

int bt_gatt_throughput_handles_assign(struct bt_gatt_dm *dm,
				      struct bt_gatt_throughput *throughput)
{
printk("[ejpark4] ???????\n");
	const struct bt_gatt_dm_attr *gatt_service_attr =
			bt_gatt_dm_service_get(dm);
	const struct bt_gatt_service_val *gatt_service =
			bt_gatt_dm_attr_service_val(gatt_service_attr);
	const struct bt_gatt_dm_attr *gatt_chrc;
	const struct bt_gatt_dm_attr *gatt_desc;

	bool flag1 = false;
	bool flag2 = false;
	for(int i = 0; i <CONFIG_BT_MAX_CONN; i ++){
		if (!bt_uuid_cmp(gatt_service->uuid, BT_UUID_THROUGHPUT)) {
			flag1 = true;	
		}
	}
	if(flag1 == false)
		return -ENOTSUP;

	LOG_DBG("Getting handles from Throughput service.");

	/* Throughput Characteristic. */
	gatt_chrc = bt_gatt_dm_char_by_uuid(dm, BT_UUID_THROUGHPUT_CHAR);
	if (!gatt_chrc) {
		LOG_ERR("Missing Throughput characteristic.");
	}

	gatt_desc = bt_gatt_dm_desc_by_uuid(dm, gatt_chrc,
					    BT_UUID_THROUGHPUT_CHAR);
	if (!gatt_desc) {
		LOG_ERR("Missing Throughput characteristic value descriptor");
		return -EINVAL;
	}
	LOG_DBG("Found handle for Throughput characteristic.");
	throughput->char_handle = gatt_desc->handle;

	/* Assign connection object. */
	throughput->conn = bt_gatt_dm_conn_get(dm);
	return 0;
}

int bt_gatt_throughput_read(struct bt_gatt_throughput *throughput)
{
	int err;

	throughput->read_params.single.handle = throughput->char_handle;
	throughput->read_params.single.offset = 0;
	throughput->read_params.handle_count = 1;
	throughput->read_params.func = read_fn;

	err = bt_gatt_read(throughput->conn, &throughput->read_params);
	if (err) {
		LOG_ERR("Characteristic read failed.");
	}

	return err;
}

int bt_gatt_throughput_write(struct bt_gatt_throughput *throughput,
			     const uint8_t *data, uint16_t len)
{
	return bt_gatt_write_without_response(throughput->conn,
					      throughput->char_handle,
					      data, len, false);
}
```
