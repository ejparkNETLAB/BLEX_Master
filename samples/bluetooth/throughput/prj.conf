## prj.conf
```kconfig
CONFIG_BT=y
CONFIG_BT_DEBUG_LOG=y
CONFIG_BT_CENTRAL=y
CONFIG_BT_SMP=y
CONFIG_BT_GATT_CLIENT=y
CONFIG_LOG=y
CONFIG_SERIAL=y

CONFIG_ENTROPY_GENERATOR=y
CONFIG_TEST_RANDOM_GENERATOR=y


CONFIG_CONSOLE_SUBSYS=y
CONFIG_CONSOLE_HANDLER=y
CONFIG_CONSOLE_GETCHAR=y

CONFIG_BT_DEVICE_NAME="Nordic_Throughput"
CONFIG_BT_SMP=y
CONFIG_BT_MAX_CONN=4
CONFIG_BT_CTLR_LLCP_CONN=4
CONFIG_ASSERT=n


CONFIG_HEAP_MEM_POOL_SIZE=2048

CONFIG_BT_RX_BUF_LEN=258
CONFIG_BT_GATT_CLIENT=y
CONFIG_BT_ATT_TX_MAX=10
CONFIG_BT_ATT_PREPARE_COUNT=2
CONFIG_BT_CONN_TX_MAX=10
CONFIG_BT_L2CAP_TX_BUF_COUNT=10
CONFIG_BT_L2CAP_DYNAMIC_CHANNEL=y
CONFIG_BT_CTLR_PHY_2M=n
CONFIG_BT_CTLR_RX_BUFFERS=10
CONFIG_BT_CTLR_TX_BUFFERS=10
CONFIG_BT_CTLR_TX_BUFFER_SIZE=251
CONFIG_BT_CTLR_ADVANCED_FEATURES=y
CONFIG_BT_CTLR_XTAL_THRESHOLD=500000
CONFIG_BT_CTLR_CONN_PARAM_REQ=y
CONFIG_BT_CTLR_SCHED_ADVANCED=n
CONFIG_BT_CTLR_XTAL_ADVANCED=n
CONFIG_BT_GATT_READ_MULTIPLE=y
CONFIG_INIT_STACKS=y
CONFIG_THREAD_STACK_INFO=y
CONFIG_MAIN_STACK_SIZE=2048
CONFIG_SYSTEM_WORKQUEUE_STACK_SIZE=4096
CONFIG_BT_RX_STACK_SIZE=4096
CONFIG_BT_CTLR_RX_PRIO_STACK_SIZE=4096
CONFIG_BT_L2CAP_TX_MTU=247
CONFIG_BT_CTLR_DATA_LENGTH_MAX=251
CONFIG_BT_HCI_CMD_COUNT=64
CONFIG_BT_RX_BUF_COUNT=255
```

## src/main.c
```c
/*
 * Copyright (c) 2018 Nordic Semiconductor ASA
 *
 * SPDX-License-Identifier: LicenseRef-BSD-5-Clause-Nordic
 *
 * In order to evaluate the performance of BLEX, it is a throughput measurement code that was modified and brought from Nordic SDK. 
 * In addition, it was modified so that several slaves can connect to one master.
 * In particular, this code accepts up to 4 slaves using the same connection interval from the master's point of view.
 */

#include <kernel.h>
#include <console/console.h>
#include <sys/printk.h>
#include <string.h>
#include <stdlib.h>
#include <zephyr/types.h>

#include <stddef.h>
#include <errno.h>
#include <zephyr.h>

#include <bluetooth/bluetooth.h>
#include <bluetooth/crypto.h>
#include <bluetooth/conn.h>
#include <bluetooth/gatt.h>
#include <bluetooth/hci.h>
#include <bluetooth/uuid.h>
#include "gatt_dm.h"
#include "throughput.h"

#define DEVICE_NAME	CONFIG_BT_DEVICE_NAME
#define DEVICE_NAME_LEN (sizeof(DEVICE_NAME) - 1)

static volatile bool test_ready = true;
static volatile bool nodes_ready = false;
static struct bt_conn *default_conn[CONFIG_BT_MAX_CONN];
static struct bt_conn *new_conn;
static bool scan_start = false;

static struct bt_gatt_throughput gatt_throughput[CONFIG_BT_MAX_CONN];
static struct bt_gatt_exchange_params exchange_params;
int cnt = 0;
int M = 10;
int old_cnt = 0;
int iter_cnt = 4;
int conn_cnt = 4;
int iter = 0;	
bool start_flag = false;
#define sys_le16_to_cpu(val)(val)
static const char img[][81] = {
#include "img.file"
};

static void exchange_func(struct bt_conn *conn, uint8_t att_err,
		struct bt_gatt_exchange_params *params)
{
	struct bt_conn_info info = {0};
	int err;


	err = bt_conn_get_info(conn, &info);
	if (err){

		return;
	}

	if (info.role == BT_CONN_ROLE_MASTER){
		iter++;
		nodes_ready = true;;
		scan_start= false;
		int i;
	}
}

static void discovery_complete(struct bt_gatt_dm *dm,
		void *context)
{
	int err;
	struct bt_gatt_throughput *throughput = context;

	bt_gatt_dm_data_print(dm);
	bt_gatt_throughput_handles_assign(dm, throughput);
	bt_gatt_dm_data_release(dm);


	exchange_params.func = exchange_func;
	err = bt_gatt_exchange_mtu(bt_gatt_dm_conn_get(dm), &exchange_params);
}

static void discovery_service_not_found(struct bt_conn *conn,
		void *context)
{
}

static void discovery_error(struct bt_conn *conn,
		int err,
		void *context)
{
}

struct bt_gatt_dm_cb discovery_cb = {
	.completed         = discovery_complete,
	.service_not_found = discovery_service_not_found,
	.error_found       = discovery_error,
};

static uint8_t throughput_read(struct bt_conn *conn, const struct bt_gatt_throughput_metrics *met)
{
	int i;
	for(i = 0; i <CONFIG_BT_MAX_CONN; i ++)
		if(default_conn[i] == conn){
			printk("\n[peer]round %u: received %u bytes (%u KB)"
					" in %u GATT writes at %u bps from slave %u\n",cnt,
					met->write_len, met->write_len / 1024, met->write_count,
					met->write_rate, i);
			i = CONFIG_BT_MAX_CONN;
		}
	test_ready = true;

	return BT_GATT_ITER_STOP;
}
static void throughput_received(const struct bt_gatt_throughput_metrics *met)
{
	static uint32_t kb;

	if (met->write_len == 0) {
		kb = 0;

		return;
	}

	if ((met->write_len / 1024) != kb) {
		kb = (met->write_len / 1024);
	}
}
static void throughput_send(const struct bt_gatt_throughput_metrics *met)
{
	printk("\n[peer] received %u bytes (%u KB)"
			" in %u GATT writes at %u bps\n",
			met->write_len, met->write_len / 1024,
			met->write_count, met->write_rate);
}
static const struct bt_gatt_throughput_cb throughput_cb = {
	.data_read = throughput_read,
	.data_received = throughput_received,
	.data_send = throughput_send
};
static void connected(struct bt_conn *conn, uint8_t hci_err)
{
	struct bt_conn_info info = {0};
	int err;
	err = bt_conn_get_info(conn, &info);
	if (err) {
		return;
	}


	char addr[BT_ADDR_LE_STR_LEN];

	bt_addr_le_to_str(bt_conn_get_dst(conn), addr, sizeof(addr));

	if (hci_err) {
		for(int i = 0; i < CONFIG_BT_MAX_CONN; i ++)
			if(default_conn[i] == conn){
				bt_conn_unref(default_conn[i]);
				default_conn[i] = NULL;
			}

		return;
	}
	printk("[peer] Conn. interval is %u units\n", info.le.interval);
	int i;
}
static bool eir_found(struct bt_data *data, void *user_data)
{
	bt_addr_le_t *addr = user_data;
	int i;

	switch (data->type) {
		case BT_DATA_UUID16_SOME:
		case BT_DATA_UUID16_ALL:
			if (data->data_len % sizeof(uint16_t) != 0U) {
				return true;
			}

			for (i = 0; i < data->data_len; i += sizeof(uint16_t)) {
				struct bt_le_conn_param *param, *param2;
				struct bt_uuid *uuid;
				uint16_t u16;
				int err;

				memcpy(&u16, &data->data[i], sizeof(u16));
				uuid = BT_UUID_DECLARE_16(sys_le16_to_cpu(u16));
				if (bt_uuid_cmp(uuid, BT_UUID_HRS)) {
					printk("WRONG UUID\n");
					continue;
				}

				/* BLEX: By modifying the value of BT_LE_CONN_PARAM_DEFAULT, we can change the connection interval*/	
				param = BT_LE_CONN_PARAM_DEFAULT;
				int number= 0;
				for(int i = 0; i <CONFIG_BT_MAX_CONN; i ++){
					if(default_conn[i] == NULL && i == 0){
						err = bt_le_scan_stop();
						if (err) {
							continue;
						}
						scan_start = false;
						err = bt_conn_le_create(addr, BT_CONN_LE_CREATE_CONN,
								param, &default_conn[i]);
						if (err) {
						}
						i = CONFIG_BT_MAX_CONN;
					}
					else if(default_conn[i] == NULL){
						err = bt_le_scan_stop();
						if (err) {
							continue;
						}
						scan_start = false;
						err = bt_conn_le_create(addr, BT_CONN_LE_CREATE_CONN,
								param, &default_conn[i]);
						if (err) {
						}
						i = CONFIG_BT_MAX_CONN;
					}else{
						number ++;
					}
				}

				return false;
			}
	}

	return true;
}

static void device_found(const bt_addr_le_t *addr, uint8_t rssi, uint8_t type,
		struct net_buf_simple *ad)
{
	char dev[BT_ADDR_LE_STR_LEN];

	bt_addr_le_to_str(addr, dev, sizeof(dev));

	/* We're only interested in connectable events */
	if (type == BT_GAP_ADV_TYPE_ADV_IND ||
			type == BT_GAP_ADV_TYPE_ADV_DIRECT_IND) {
		bt_data_parse(ad, eir_found, (void *)addr);

	}
}


void start_scan(void)
{

	int err;
	if(iter < conn_cnt) nodes_ready = false;
	scan_start= true;
	/* Use active scanning and disable duplicate filtering to handle any
	 * devices that might update their advertising data at runtime. */
	struct bt_le_scan_param scan_param = {
		.type       = BT_LE_SCAN_TYPE_ACTIVE,
		.options    = BT_LE_SCAN_OPT_NONE,
		.interval   = BT_GAP_SCAN_FAST_INTERVAL,
		.window     = BT_GAP_SCAN_FAST_WINDOW,
	};

	err = bt_le_scan_start(&scan_param, device_found);
	if (err) {
		return;
	}

	printk("[peer]Scanning successfully started\n");
}
static void disconnected(struct bt_conn *conn, uint8_t reason)
{
	struct bt_conn_info info = {0};
	int err;

	for(int i = 0; i<CONFIG_BT_MAX_CONN; i ++)
		if(conn == default_conn[i]){
			printk("[peer]disconnected\n");
			bt_conn_unref(conn);
			default_conn[i] = NULL;
			cnt = 0;
			iter -= 1;
			i = CONFIG_BT_MAX_CONN;
		}
	err = bt_conn_get_info(conn, &info);
	if (err) {
		return;
	}

	/* Re-connect using same roles */
	if (info.role == BT_CONN_ROLE_MASTER) {
	}
}


static bool le_param_req(struct bt_conn *conn, struct bt_le_conn_param *param)
{
	/* reject peer conn param request */
	return false;
}

void main(void)
{
	int err;

	static struct bt_conn_cb conn_callbacks = {
		.connected = connected,
		.disconnected = disconnected,
		.le_param_req = le_param_req,
	};

	bt_conn_cb_register(&conn_callbacks);

	err = bt_enable(NULL);
	if (err) {
		return;
	}
	for(int i = 0; i<CONFIG_BT_MAX_CONN; i ++){
		default_conn[i] = NULL;
	}

	for(int i = 0; i <CONFIG_BT_MAX_CONN; i ++){
		err = bt_gatt_throughput_init(&gatt_throughput[i], &throughput_cb);
	}

	if (err) {
		return;
	}
	test_ready = true;

	for ( ;;) {
		if(default_conn[CONFIG_BT_MAX_CONN-1] == NULL)
			start_scan();
		uint32_t stamp = k_uptime_get_32();
		while(k_uptime_get_32()-stamp < 15000);
	}

}
```

## src/gatt_dm.c
```c
/*
 * Copyright (c) 2018 Nordic Semiconductor ASA
 *
 * SPDX-License-Identifier: LicenseRef-BSD-5-Clause-Nordic
 */

#include <inttypes.h>
#include <zephyr.h>
#include <logging/log.h>
#include <bluetooth/conn.h>
#include <bluetooth/bluetooth.h>
#include <bluetooth/crypto.h>
#include <bluetooth/gatt.h>
#include <bluetooth/hci.h>
#include <bluetooth/uuid.h>

#include "gatt_dm.h"

LOG_MODULE_REGISTER(bt_gatt_dm, LOG_LEVEL_DBG);

/* Available sizes: 128, 512, 2048... */
#define CHUNK_DATA_SIZE (128 - sizeof(struct k_mem_block_id) \
		- sizeof(struct data_chunk_item *))

#define DATA_ALIGN 4U

#define CONFIG_BT_GATT_DM_MAX_ATTRS 35
/* They are placed in data_chunk without padding, so they must be aligned */
BUILD_ASSERT(sizeof(struct bt_gatt_service_val) % DATA_ALIGN == 0);
BUILD_ASSERT(sizeof(struct bt_gatt_chrc) % DATA_ALIGN == 0);

/* Flags for parsed attribute array state */
enum {
	STATE_ATTRS_LOCKED,
	STATE_ATTRS_RELEASE_PENDING,
	STATE_NUM
};

/* One item in linked list containing dynamically allocated user data chunks */
struct data_chunk_item {
	/* Required by the sys_slist */
	sys_snode_t node;
	/* User data storage */
	uint8_t data[CHUNK_DATA_SIZE];
};

/* The instance structure real declaration */
struct bt_gatt_dm {
	/* Connection object */
	struct bt_conn *conn;
	/* The user context */
	void *context;

	/* The discovery parameters used */
	struct bt_gatt_discover_params discover_params;
	/* Currently parsed attributes */
	struct bt_gatt_dm_attr attrs[CONFIG_BT_GATT_DM_MAX_ATTRS];
	/* Currently accessed attribute */
	size_t cur_attr_id;
	/* Flags with the status of the attributes */
	ATOMIC_DEFINE(state_flags, STATE_NUM);

	/* Single-linked list of allocated chunks for user data */
	sys_slist_t chunk_list;
	/* The used length of the current chunk */
	size_t cur_chunk_len;

	/* The pointer to callback structure */
	const struct bt_gatt_dm_cb *callback;
};

/* Currently only one instance is supported */
static struct bt_gatt_dm bt_gatt_dm_inst[CONFIG_BT_MAX_CONN];

/* Returns pointer to newly allocated space in a dm->data_chunk */
static void *user_data_alloc(struct bt_gatt_dm *dm,
			     size_t len)
{
	uint8_t *user_data_loc;
	struct data_chunk_item *item;

	/* Round up len to 32 bits to make sure that return pointers are always
	 * correctly aligned.
	 */
	len = (len + DATA_ALIGN - 1) & ~(DATA_ALIGN - 1);

	__ASSERT_NO_MSG(len <= CHUNK_DATA_SIZE);

	if (sys_slist_is_empty(&dm->chunk_list) ||
	    dm->cur_chunk_len + len > CHUNK_DATA_SIZE) {

		item = k_malloc(sizeof(struct data_chunk_item));

		if (!item) {
			return NULL;
		}

		sys_slist_append(&dm->chunk_list, &item->node);
		dm->cur_chunk_len = 0;

	} else {

		item = SYS_SLIST_PEEK_TAIL_CONTAINER(&dm->chunk_list, item,
						     node);

	}

	user_data_loc = &item->data[dm->cur_chunk_len];
	dm->cur_chunk_len += len;

	return user_data_loc;
}

static void svc_attr_memory_release(struct bt_gatt_dm *dm)
{
	sys_snode_t *node;
	struct data_chunk_item *item;

	LOG_DBG("Attr memory release");

	/* Clear attributes */
	dm->cur_attr_id = 0;

	/* Release dynamic memory data chunks */
	while (!sys_slist_is_empty(&dm->chunk_list)) {
		node = sys_slist_get_not_empty(&dm->chunk_list);
		item = CONTAINER_OF(node, struct data_chunk_item, node);
		k_free(item);
	}

	dm->cur_chunk_len = 0;
}

/* Returns size of UUID structure with padding for memory alignment */
static size_t get_uuid_size(const struct bt_uuid *uuid)
{
	switch (uuid->type) {
	case BT_UUID_TYPE_16:
		return sizeof(struct bt_uuid_16);
	case BT_UUID_TYPE_32:
		return sizeof(struct bt_uuid_32);
	case BT_UUID_TYPE_128:
		return sizeof(struct bt_uuid_128);
	default:
		LOG_ERR("Unsupported UUID type.");
		return 0;
	}
}

/** @brief Stores attribute in bt_gatt_dm instance.
 *
 * This function stores attr at dm->attrs array. Its UUID is stored in
 * dm->data_chunk. The Discovery Manager attribute does not contain
 * a pointer to the context data. This data could be either
 * bt_gatt_service_val or bt_gatt_chrc. It is assumed that attribute context
 * data (if any) is always placed before its UUID data. For this purpose,
 * an additional buffer is allocated by this function and used later.
 *
 * @param[in] dm             Discovery instance
 * @param[in] attr           Service attribute
 * @param[in] additional_len Additional buffer length
 *
 * @return Pointer to newly stored attribute.
 */
static struct bt_gatt_dm_attr *attr_store(struct bt_gatt_dm *dm,
					  const struct bt_gatt_attr *attr,
					  size_t additional_len)
{
	struct bt_gatt_dm_attr *cur_attr;

	LOG_DBG("Attr store, pos: %zu, handle: %"PRIu16,
		dm->cur_attr_id,
		attr->handle);
	if (dm->cur_attr_id >= ARRAY_SIZE(dm->attrs)) {
		LOG_ERR("No space for new attribute.");
		return NULL;
	}

	size_t uuid_size = get_uuid_size(attr->uuid);
	uint8_t *attr_data = user_data_alloc(dm, additional_len + uuid_size);

	if (!attr_data) {
		LOG_ERR("No space for attribute data.");
		return NULL;
	}

	cur_attr = &dm->attrs[(dm->cur_attr_id)++];
	cur_attr->handle = attr->handle;
	cur_attr->perm = attr->perm;
	cur_attr->uuid = (struct bt_uuid *)&attr_data[additional_len];

	memcpy(cur_attr->uuid, attr->uuid, uuid_size);

	return cur_attr;
}

static struct bt_uuid *uuid_store(struct bt_gatt_dm *dm,
				  const struct bt_uuid *uuid)
{
	if (!uuid) {
		LOG_ERR("Uninitialized UUID.");
		return NULL;
	}

	size_t size = get_uuid_size(uuid);
	void *buffer = user_data_alloc(dm, size);

	memcpy(buffer, uuid, size);

	return (struct bt_uuid *)buffer;
}

static struct bt_gatt_dm_attr *attr_find_by_handle(
	struct bt_gatt_dm *dm,
	uint16_t handle)
{
	if (!dm->cur_attr_id) {
		return NULL;
	}

	ssize_t lower = 0;
	ssize_t upper = dm->cur_attr_id - 1;

	while (upper >= lower) {
		size_t m = (lower + upper) / 2;
		struct bt_gatt_dm_attr *cur_attr = &dm->attrs[m];

		if (cur_attr->handle < handle) {
			lower = m + 1;
		} else if (cur_attr->handle > handle) {
			upper = m - 1;
		} else {
			return cur_attr;
		}
	}

	/* handle not found */
	return NULL;
}

static void discovery_complete(struct bt_gatt_dm *dm)
{
	LOG_DBG("Discovery complete.");
	atomic_set_bit(dm->state_flags, STATE_ATTRS_RELEASE_PENDING);
	if (dm->callback->completed) {
		dm->callback->completed(dm, dm->context);
	}
}

static void discovery_complete_not_found(struct bt_gatt_dm *dm)
{
	LOG_DBG("Discover complete. No service found.");

	svc_attr_memory_release(dm);
	atomic_clear_bit(dm->state_flags, STATE_ATTRS_LOCKED);

	if (dm->callback->service_not_found) {
		dm->callback->service_not_found(dm->conn, dm->context);
	}
}

static void discovery_complete_error(struct bt_gatt_dm *dm, int err)
{
	svc_attr_memory_release(dm);
	atomic_clear_bit(dm->state_flags, STATE_ATTRS_LOCKED);
	if (dm->callback->error_found) {
		dm->callback->error_found(dm->conn, err, dm->context);
	}
}

static uint8_t discovery_process_service(struct bt_gatt_dm *dm,
				      const struct bt_gatt_attr *attr,
				      struct bt_gatt_discover_params *params)
{
	int err;

	if (!attr) {
		discovery_complete_not_found(dm);
		return BT_GATT_ITER_STOP;
	}

	struct bt_gatt_service_val *service_val = attr->user_data;
	struct bt_gatt_dm_attr *cur_attr =
		attr_store(dm, attr, sizeof(*service_val));

	__ASSERT_NO_MSG(bt_uuid_cmp(attr->uuid, BT_UUID_GATT_PRIMARY) == 0 ||
			bt_uuid_cmp(attr->uuid, BT_UUID_GATT_SECONDARY) == 0);

	if (!cur_attr) {
		LOG_ERR("Not enough memory for service attribute.");
		discovery_complete_error(dm, -ENOMEM);
		return BT_GATT_ITER_STOP;
	}

	LOG_DBG("Service detected, handles range: <%u, %u>",
		cur_attr->handle + 1,
		service_val->end_handle);

	struct bt_gatt_service_val *cur_service_val =
		bt_gatt_dm_attr_service_val(cur_attr);
	memcpy(cur_service_val, service_val, sizeof(*cur_service_val));

	cur_service_val->uuid = uuid_store(dm, cur_service_val->uuid);

	if (!cur_service_val->uuid) {
		LOG_ERR("Not enough memory for service attribute data.");
		discovery_complete_error(dm, -ENOMEM);
		return BT_GATT_ITER_STOP;
	}

	dm->discover_params.uuid         = NULL;
	dm->discover_params.type         = BT_GATT_DISCOVER_ATTRIBUTE;
	dm->discover_params.start_handle = cur_attr->handle + 1;//here
	dm->discover_params.end_handle   = cur_service_val->end_handle;
	LOG_DBG("Starting descriptors discovery");
	err = bt_gatt_discover(dm->conn, &(dm->discover_params));

	if (err) {
		LOG_ERR("Descriptor discover failed, error: %d.", err);
		discovery_complete_error(dm, -ENOMEM);
		return BT_GATT_ITER_STOP;
	}

	return BT_GATT_ITER_STOP;
}

static uint8_t discovery_process_attribute(struct bt_gatt_dm *dm,
					 const struct bt_gatt_attr *attr,
					 struct bt_gatt_discover_params *params)
{
	struct bt_gatt_dm_attr *cur_attr;

	if (!attr) {
		if (dm->cur_attr_id > 1) {
			LOG_DBG("Starting characteristic discovery");
			dm->discover_params.start_handle =
				dm->attrs[0].handle + 1;
			dm->discover_params.type =
				BT_GATT_DISCOVER_CHARACTERISTIC;
			int err = bt_gatt_discover(dm->conn,
						   &(dm->discover_params));

			if (err) {
				LOG_ERR("Characteristic discover failed,"
					" error: %d.",
					err);
				discovery_complete_error(dm, err);
			}
		} else {
			discovery_complete(dm);
		}
		return BT_GATT_ITER_STOP;
	}

	if (bt_uuid_cmp(attr->uuid, BT_UUID_GATT_CHRC) == 0) {
		cur_attr = attr_store(dm, attr, sizeof(struct bt_gatt_chrc));
	} else {
		cur_attr = attr_store(dm, attr, 0);
	}

	if (!cur_attr) {
		LOG_ERR("Not enough memory for next attribute descriptor"
			" at handle %u.",
			attr->handle);
		discovery_complete_error(dm, -ENOMEM);
		return BT_GATT_ITER_STOP;
	}

	return BT_GATT_ITER_CONTINUE;
}

static uint8_t discovery_process_characteristic(
		struct bt_gatt_dm *dm,
		const struct bt_gatt_attr *attr,
		struct bt_gatt_discover_params *params)
{
	struct bt_gatt_chrc *gatt_chrc;
	struct bt_gatt_dm_attr *cur_attr;
	struct bt_gatt_chrc *cur_gatt_chrc;

	if (!attr) {
		discovery_complete(dm);
		return BT_GATT_ITER_STOP;
	}

	__ASSERT_NO_MSG(bt_uuid_cmp(attr->uuid, BT_UUID_GATT_CHRC) == 0);

	cur_attr = attr_find_by_handle(dm, attr->handle);
	if (!cur_attr) {
		/* We should never be here is the server is working properly */
		discovery_complete_error(dm, -ESRCH);
		return BT_GATT_ITER_STOP;
	}

	gatt_chrc = attr->user_data;
	cur_gatt_chrc = bt_gatt_dm_attr_chrc_val(cur_attr);
	memcpy(cur_gatt_chrc, gatt_chrc, sizeof(*cur_gatt_chrc));
	cur_gatt_chrc->uuid = uuid_store(dm, cur_gatt_chrc->uuid);
	if (!cur_gatt_chrc->uuid) {
		discovery_complete_error(dm, -ENOMEM);
		return BT_GATT_ITER_STOP;
	}

	return BT_GATT_ITER_CONTINUE;
}

static uint8_t discovery_callback(struct bt_conn *conn,
			       const struct bt_gatt_attr *attr,
			       struct bt_gatt_discover_params *params)
{
	if (!attr) {
		LOG_DBG("NULL attribute");
	} else {
		LOG_DBG("Attr: handle %u", attr->handle);
	}
	bool flag_ej = false;
	int i;
	for(i = 0; i <CONFIG_BT_MAX_CONN && flag_ej == false;)
		if (conn == bt_gatt_dm_inst[i].conn) {
			flag_ej = true;
		}
		else i ++;
	if(!flag_ej){
		LOG_ERR("Unexpected conn object. Aborting.");

		return BT_GATT_ITER_STOP;
	}
	switch (params->type) {
	case BT_GATT_DISCOVER_PRIMARY:
	case BT_GATT_DISCOVER_SECONDARY:
		return discovery_process_service(&(bt_gatt_dm_inst[i]),
						 attr, params);
	case BT_GATT_DISCOVER_ATTRIBUTE:
		return discovery_process_attribute(&(bt_gatt_dm_inst[i]),
						   attr, params);
	case BT_GATT_DISCOVER_CHARACTERISTIC:
		return discovery_process_characteristic(&(bt_gatt_dm_inst[i]),
							attr,
							params);
	default:
		/* This should not be possible */
		__ASSERT(false, "Unknown param type.");
		break;
	}

	return BT_GATT_ITER_STOP;
}

struct bt_gatt_service_val *bt_gatt_dm_attr_service_val(
	const struct bt_gatt_dm_attr *attr)
{
	if ((!bt_uuid_cmp(BT_UUID_GATT_PRIMARY, attr->uuid)) ||
	    (!bt_uuid_cmp(BT_UUID_GATT_SECONDARY, attr->uuid))) {
		return &((struct bt_gatt_service_val *)attr->uuid)[-1];
	}
	return NULL;
}

struct bt_gatt_chrc *bt_gatt_dm_attr_chrc_val(
	const struct bt_gatt_dm_attr *attr)
{
	if (!bt_uuid_cmp(BT_UUID_GATT_CHRC, attr->uuid)) {
		return &((struct bt_gatt_chrc *)attr->uuid)[-1];
	}
	return NULL;
}

struct bt_conn *bt_gatt_dm_conn_get(struct bt_gatt_dm *dm)
{
	return dm->conn;
}

size_t bt_gatt_dm_attr_cnt(const struct bt_gatt_dm *dm)
{
	return dm->cur_attr_id;
}

const struct bt_gatt_dm_attr *bt_gatt_dm_service_get(
	const struct bt_gatt_dm *dm)
{
	return &(dm->attrs[0]);
}

const struct bt_gatt_dm_attr *bt_gatt_dm_char_next(
	const struct bt_gatt_dm *dm,
	const struct bt_gatt_dm_attr *prev)
{
	if (!prev) {
		prev = dm->attrs;
	}

	if (dm->attrs <= prev) {
		const struct bt_gatt_dm_attr *const end =
			&(dm->attrs[dm->cur_attr_id]);
		while (++prev < end) {
			if (!bt_uuid_cmp(BT_UUID_GATT_CHRC, prev->uuid)) {
				return prev;
			}
		}
	}

	return NULL;
}

const struct bt_gatt_dm_attr *bt_gatt_dm_char_by_uuid(
	const struct bt_gatt_dm *dm,
	const struct bt_uuid *uuid)
{
	const struct bt_gatt_dm_attr *curr = NULL;

	while ((curr = bt_gatt_dm_char_next(dm, curr)) != NULL) {
		struct bt_gatt_chrc *chrc = bt_gatt_dm_attr_chrc_val(curr);

		__ASSERT_NO_MSG(chrc != NULL);
		if (!bt_uuid_cmp(uuid, chrc->uuid)) {
			return curr;
		}
	}

	return NULL;
}

const struct bt_gatt_dm_attr *bt_gatt_dm_attr_by_handle(
	const struct bt_gatt_dm *dm,
	uint16_t handle)
{
	return attr_find_by_handle((struct bt_gatt_dm *)dm, handle);
}

const struct bt_gatt_dm_attr *bt_gatt_dm_attr_next(
	const struct bt_gatt_dm *dm,
	const struct bt_gatt_dm_attr *prev)
{
	if (!prev) {
		prev = dm->attrs;
	}

	if (dm->attrs <= prev) {
		const struct bt_gatt_dm_attr *const end =
			&(dm->attrs[dm->cur_attr_id]);
		if (++prev < end) {
			return prev;
		}
	}

	return NULL;
}

const struct bt_gatt_dm_attr *bt_gatt_dm_desc_by_uuid(
	const struct bt_gatt_dm *dm,
	const struct bt_gatt_dm_attr *attr_chrc,
	const struct bt_uuid *uuid)
{
	const struct bt_gatt_dm_attr *curr = attr_chrc;

	while ((curr = bt_gatt_dm_desc_next(dm, curr)) != NULL) {
		if (!bt_uuid_cmp(uuid, curr->uuid)) {
			break;
		}
	}

	return curr;
}

const struct bt_gatt_dm_attr *bt_gatt_dm_desc_next(
	const struct bt_gatt_dm *dm,
	const struct bt_gatt_dm_attr *prev)
{
	const struct bt_gatt_dm_attr *curr = bt_gatt_dm_attr_next(dm, prev);

	if (curr && !bt_uuid_cmp(BT_UUID_GATT_CHRC, curr->uuid)) {
		curr = NULL;
	}

	return curr;
}

int bt_gatt_dm_start(struct bt_conn *conn,
		     const struct bt_uuid *svc_uuid,
		     const struct bt_gatt_dm_cb *cb,
		     void *context)
{
	int err;
	struct bt_gatt_dm *dm;
	if (svc_uuid &&
	    (svc_uuid->type != BT_UUID_TYPE_16) &&
	    (svc_uuid->type != BT_UUID_TYPE_128)) {
		return -EINVAL;
	}

	if (!cb) {
		return -EINVAL;
	}
	int i;
	for(i = 0; i < CONFIG_BT_MAX_CONN; i ++){
		if(conn == bt_conn_lookup_handle(i)) {
			dm = &bt_gatt_dm_inst[i];
		}
	}

	if (atomic_test_and_set_bit(dm->state_flags, STATE_ATTRS_LOCKED)) {
		return -EALREADY;
	}

	dm->conn = conn;
	dm->context = context;
	dm->callback = cb;
	dm->cur_attr_id = 0;
	sys_slist_init(&dm->chunk_list);
	dm->cur_chunk_len = 0;

	dm->discover_params.uuid = svc_uuid ? uuid_store(dm, svc_uuid) : NULL;
	dm->discover_params.func = discovery_callback;

		
	dm->discover_params.start_handle = 0x0001;
	dm->discover_params.end_handle = 0xffff;
	
	dm->discover_params.type = BT_GATT_DISCOVER_PRIMARY;

	err = bt_gatt_discover(conn, &dm->discover_params);
	
	if (err) {
		LOG_ERR("Discover failed, error: %d.", err);
		atomic_clear_bit(dm->state_flags, STATE_ATTRS_LOCKED);
	}

	return err;
}

int bt_gatt_dm_continue(struct bt_gatt_dm *dm, void *context)
{
	int err;

	if ((!dm) ||
	    (!dm->callback) ||
	    (dm->discover_params.func != discovery_callback)) {
		return -EINVAL;
	}

	/* If UUID is set, it does not make sense to call this function.
	 * The stored UUID would be broken anyway in bt_gatt_dm_data_release.
	 */
	if (dm->discover_params.uuid) {
		return -EINVAL;
	}

	if (atomic_test_and_set_bit(dm->state_flags, STATE_ATTRS_LOCKED)) {
		return -EALREADY;
	}

	if (dm->discover_params.end_handle == 0xffff) {
		/* No more handles to discover. */
		discovery_complete_not_found(dm);
		return 0;
	}

	dm->context = context;
	dm->discover_params.start_handle = dm->discover_params.end_handle + 1;//here
	dm->discover_params.end_handle = 0xffff;
	dm->discover_params.type = BT_GATT_DISCOVER_PRIMARY;

	err = bt_gatt_discover(dm->conn, &dm->discover_params);
	if (err) {
		LOG_ERR("Discover failed, error: %d.", err);
		atomic_clear_bit(dm->state_flags, STATE_ATTRS_LOCKED);
	}

	return err;
}

int bt_gatt_dm_data_release(struct bt_gatt_dm *dm)
{
	if (!atomic_test_and_clear_bit(dm->state_flags,
				       STATE_ATTRS_RELEASE_PENDING)) {
		return -EALREADY;
	}

	svc_attr_memory_release(dm);
	atomic_clear_bit(dm->state_flags, STATE_ATTRS_LOCKED);

	return 0;
}

#if CONFIG_BT_GATT_DM_DATA_PRINT

#define UUID_STR_LEN 37

static void svc_attr_data_print(const struct bt_gatt_service_val *gatt_service)
{
	char str[UUID_STR_LEN];

	bt_uuid_to_str(gatt_service->uuid, str, sizeof(str));
}

static void chrc_attr_data_print(const struct bt_gatt_chrc *gatt_chrc)
{
	char str[UUID_STR_LEN];

	bt_uuid_to_str(gatt_chrc->uuid, str, sizeof(str));
}

static void attr_print(const struct bt_gatt_dm *dm,
		       const struct bt_gatt_dm_attr *attr)
{
	char str[UUID_STR_LEN];

	bt_uuid_to_str(attr->uuid, str, sizeof(str));

	if ((bt_uuid_cmp(attr->uuid, BT_UUID_GATT_PRIMARY) == 0) ||
	    (bt_uuid_cmp(attr->uuid, BT_UUID_GATT_SECONDARY) == 0)) {
		svc_attr_data_print(bt_gatt_dm_attr_service_val(attr));
	} else if (bt_uuid_cmp(attr->uuid, BT_UUID_GATT_CHRC) == 0) {
		chrc_attr_data_print(bt_gatt_dm_attr_chrc_val(attr));
	} else if (bt_uuid_cmp(attr->uuid, BT_UUID_GATT_CCC) == 0) {
	}
}

void bt_gatt_dm_data_print(const struct bt_gatt_dm *dm)
{
	const struct bt_gatt_dm_attr *attr = NULL;

	while (NULL != (attr = bt_gatt_dm_attr_next(dm, attr))) {
		attr_print(dm, attr);
	}
}

#endif /* CONFIG_BT_GATT_DM_DATA_PRINT */
```

## src/gatt_dm.h
```c
/*
 * Copyright (c) 2018 Nordic Semiconductor ASA
 *
 * SPDX-License-Identifier: LicenseRef-BSD-5-Clause-Nordic
 */

#ifndef BT_GATT_DM_H_
#define BT_GATT_DM_H_

/**
 * @file
 * @defgroup bt_gatt_dm GATT Discovery Manager API
 * @{
 * @brief Module for GATT Discovery Manager.
 */

#include <bluetooth/gatt.h>
#include <bluetooth/uuid.h>

#ifdef __cplusplus
extern "C" {
#endif

/** @brief Discovery Manager instance
 *
 * The instance of the manager used by most of the functions here.
 */
struct bt_gatt_dm;

/** @brief Discovery Manager GATT attribute
 *
 * This structure is used to hold GATT attribute information.
 * The Discovery Manager attribute descriptor is a reduced version of
 * @ref bt_gatt_attr. The new definition is used to save memory that is used
 * by this module.
 */
struct bt_gatt_dm_attr {
	/** Attribute UUID */
	struct bt_uuid	*uuid;
	/** Attribute handle */
	uint16_t		handle;
	/** Attribute permissions */
	uint8_t		perm;
};

/** @brief Discovery callback structure.
 *
 *  This structure is used for tracking the result of a discovery.
 */
struct bt_gatt_dm_cb {
	/** @brief Discovery completed callback.
	 *
	 * The discovery procedure has completed successfully.
	 *
	 * @note You must release the discovery data with
	 * @ref bt_gatt_dm_data_release if you want to start another
	 * discovery.
	 *
	 * @param[in,out] dm Discovery Manager instance
	 * @param[in,out] context The value passed to
	 *                @ref gatt_db_discovery_start
	 */
	void (*completed)(struct bt_gatt_dm *dm,
			  void *context);

	/** @brief Service not found callback.
	 *
	 * The targeted service could not be found during the discovery.
	 *
	 * @param[in,out] conn Connection object.
	 * @param[in,out] context The value passed to
	 *                @ref gatt_db_discovery_start
	 */
	void (*service_not_found)(struct bt_conn *conn,
				  void *context);

	/** @brief Discovery error found callback.
	 *
	 * The discovery procedure has failed.
	 *
	 * @param[in,out] conn Connection object.
	 * @param[in]     err The error code.
	 * @param[in,out] context The value passed to
	 *                @ref gatt_db_discovery_start
	 */
	void (*error_found)(struct bt_conn *conn,
			    int err,
			    void *context);
};

/** @brief Access service value saved with service attribute
 *
 * This function access the service value parsed and saved previously
 * in the user_data attribute field.
 *
 * @note Use it only on the attribute parsed in this module.
 *       To access service attribute use @ref bt_gatt_dm_service_get function.
 *
 * @param[in] attr Service attribute
 *
 * @return The service value from the parsed attribute
 *         or NULL when attribute UUID value is unexpected.
 */
struct bt_gatt_service_val *bt_gatt_dm_attr_service_val(
	const struct bt_gatt_dm_attr *attr);

/** @brief Access characteristic value saved with characteristic attribute
 *
 * This function access the characteristic value parsed
 * and saved previously in the user_data attribute field.
 *
 * @note Use it only on the attribute parsed in this module.
 *       To access characteristic attribute use
 *       @ref bt_gatt_dm_char_next function.
 *
 * @param[in] attr Characteristic attribute
 *
 * @return The characteristic value from parser attribute
 *         or NULL when attribute UUID value is unexpected.
 */
struct bt_gatt_chrc *bt_gatt_dm_attr_chrc_val(
	const struct bt_gatt_dm_attr *attr);

/** @brief Get the connection object
 *
 * Function returns connection object that is used by given
 * discovery manager instance.
 *
 * @param[in] dm Discovery Manager instance
 *
 * @return Connection object.
 */
struct bt_conn *bt_gatt_dm_conn_get(struct bt_gatt_dm *dm);

/** @brief Get total number of attributes decoded
 *
 * The number of attributes including the service attribute.
 * It means that service without any attribute would return 1 here.
 *
 * @param[in] dm Discovery Manager instance.
 *
 * @return Total number of attributes parsed.
 */
size_t bt_gatt_dm_attr_cnt(const struct bt_gatt_dm *dm);

/** @brief Get service value
 *
 * Function returns the value that contains UUID and attribute
 * end handler of the service found.
 *
 * @param[in] dm Discovery Manager instance.
 *
 * @return The pointer service value structure.
 */
const struct bt_gatt_dm_attr *bt_gatt_dm_service_get(
	const struct bt_gatt_dm *dm);

/** @brief Get next characteristic
 *
 * @param[in] dm Discovery Manager instance.
 * @param[in] prev An attribute where start to search.
 *            If NULL - the first characteristic in the service would be found.
 *            Note: It can be the previous characteristic attribute or the
 *            last descriptor inside the previous attribute.
 *            Function would start searching for the next characteristic
 *            from that point.
 *
 * @return The pointer for an attribute that describes the characteristic
 *         or NULL if no more characteristic is present.
 */
const struct bt_gatt_dm_attr *bt_gatt_dm_char_next(
	const struct bt_gatt_dm *dm,
	const struct bt_gatt_dm_attr *prev);

/** @brief Get the characteristic by its UUID
 *
 * Function finds characteristic attribute by the UUID stored in its
 * characteristic value.
 * If the selected characteristic is not found in parsed service
 * it returns NULL.
 *
 * @param[in] dm Discovery instance
 * @param[in] uuid The UUID of the characteristic
 *
 * @return The characteristic attribute
 *         (the one with UUID set to @ref BT_UUID_GATT_CHRC)
 *         with the selected UUID inside the characteristic value.
 *         Returns NULL if no such characteristic is present in the
 *         current service.
 */
const struct bt_gatt_dm_attr *bt_gatt_dm_char_by_uuid(
	const struct bt_gatt_dm *dm,
	const struct bt_uuid *uuid);

/** @brief Get attribute by handle
 *
 * Function returns any type of the attribute using its handle.
 *
 * @param[in] dm Discovery Manager instance.
 * @param[in] handle The handle to find
 *
 * @return The pointer to the attribute or NULL if there is no
 *         attribute with such a pointer.
 */
const struct bt_gatt_dm_attr *bt_gatt_dm_attr_by_handle(
	const struct bt_gatt_dm *dm, uint16_t handle);

/** @brief Get next attribute
 *
 * Function returns the attribute next to the given one.
 * It returns any type of the attribute.
 *
 * @param[in] dm Discovery Manager instance.
 * @param[in] prev Previous attribute or NULL if we wish to get
 *            first attribute (just after service).
 *
 * @return Attribute next to the @c prev
 *         or the first attribute if NULL is given.
 */
const struct bt_gatt_dm_attr *bt_gatt_dm_attr_next(
	const struct bt_gatt_dm *dm,
	const struct bt_gatt_dm_attr *prev);


/** @brief Search the descriptor by UUID
 *
 * Function searches for the descriptor with given UUID
 * inside given characteristic.
 *
 * @param[in] dm Discovery Manager instance.
 * @param[in] attr_chrc The characteristic attribute where to search
 * @param[in] uuid The UUID of the searched descriptor.
 *
 * @return Pointer to the attribute or NULL if the attribute cannot be found.
 */
const struct bt_gatt_dm_attr *bt_gatt_dm_desc_by_uuid(
	const struct bt_gatt_dm *dm,
	const struct bt_gatt_dm_attr *attr_chrc,
	const struct bt_uuid *uuid);

/** @brief Get next descriptor
 *
 * Function returns next descriptor.
 * The difference between this function and @ref bt_gatt_dm_attr_next is that
 * it returns NULL also when returned attribute appears to be next
 * characteristic.
 *
 * @param[in] dm Discovery Manager instance.
 * @param[in] prev Previous attribute.
 *            The characteristic if we wish to get first descriptor
 *            or previous descriptor.
 *            If NULL or pointer to service attribute is given
 *            the result is undefined.
 *
 * @return The pointer to the descriptor attribute
 *         or NULL if there is no more descriptors in the characteristic.
 */
const struct bt_gatt_dm_attr *bt_gatt_dm_desc_next(
	const struct bt_gatt_dm *dm,
	const struct bt_gatt_dm_attr *prev);

/** @brief Start service discovery.
 *
 * This function is asynchronous. Discovery results are passed through
 * the supplied callback.
 *
 * @note Only one discovery procedure can be started simultaneously. To start
 * another one, wait for the result of the previous procedure to finish
 * and call @ref bt_gatt_dm_data_release if it was successful.
 *
 * @param[in]     conn Connection object.
 * @param[in]     svc_uuid UUID of target service
 *                or NULL if any service should be discovered.
 * @param[in]     cb Callback structure.
  * @param[in,out] context Context argument to be passed to
  *                callback functions.
 *
 * @note
 * If @p svc_uuid is set to NULL, all services may be discovered.
 * To process the next service, call @ref bt_gatt_dm_continue.
 *
 * @retval 0 If the operation was successful.
 *           Otherwise, a (negative) error code is returned.
 */
int bt_gatt_dm_start(struct bt_conn *conn,
		     const struct bt_uuid *svc_uuid,
		     const struct bt_gatt_dm_cb *cb,
		     void *context);

/** @brief Continue service discovery.
 *
 * This function continues service discovery.
 * Call it after the previous data was released by @ref bt_gatt_dm_data_release.
 *
 * @param[in,out] dm Discovery Manager instance.
 * @param[in]     context Context argument to
 *                be passed to callback functions.
 *
 * @retval 0 If the operation was successful.
 *         Otherwise, a (negative) error code is returned.
 */
int bt_gatt_dm_continue(struct bt_gatt_dm *dm, void *context);

/** @brief Release data associated with service discovery.
 *
 * After calling this function, you cannot rely on the discovery data that was
 * passed with the discovery completed callback (see @ref bt_gatt_dm_cb).
 *
 * @param[in] dm Discovery Manager instance
 *
 * @retval 0 If the operation was successful.
 *           Otherwise, a (negative) error code is returned.
 */
int bt_gatt_dm_data_release(struct bt_gatt_dm *dm);

/** @brief Print service discovery data.
 *
 * This function prints GATT attributes that belong to the discovered service.
 *
 * @param[in] dm Discovery Manager instance
 */
#ifdef CONFIG_BT_GATT_DM_DATA_PRINT
void bt_gatt_dm_data_print(const struct bt_gatt_dm *dm);
#else
static inline void bt_gatt_dm_data_print(const struct bt_gatt_dm *dm)
{
}
#endif

#ifdef __cplusplus
}
#endif

/**
 * @}
 */

#endif /* BT_GATT_DM_H_ */
```

## src/throughput.c
```c
/*
 * Copyright (c) 2018 Nordic Semiconductor ASA
 *
 * SPDX-License-Identifier: LicenseRef-BSD-5-Clause-Nordic
 */

#include <kernel.h>
#include <sys/printk.h>
#include <string.h>
#include <zephyr/types.h>

#include <bluetooth/bluetooth.h>
#include <bluetooth/conn.h>
#include <bluetooth/gatt.h>
#include <bluetooth/hci.h>
#include <bluetooth/uuid.h>

#include "throughput.h"

#include <logging/log.h>

LOG_MODULE_REGISTER(bt_gatt_throughput, LOG_LEVEL_DBG);

static struct bt_gatt_throughput_metrics met;
static const struct bt_gatt_throughput_cb *callbacks;

static uint8_t read_fn(struct bt_conn *conn, uint8_t err,
		    struct bt_gatt_read_params *params, const void *data,
		    uint16_t len)
{
	struct bt_gatt_throughput_metrics metrics;

	memset(&metrics, 0, sizeof(struct bt_gatt_throughput_metrics));

	if (data) {
		len = MIN(len, sizeof(struct bt_gatt_throughput_metrics));
		memcpy(&metrics, data, len);

		if (callbacks->data_read) {
			return callbacks->data_read(conn, &metrics);
		}
	}

	return BT_GATT_ITER_STOP;
}

static ssize_t write_callback(struct bt_conn *conn,
			      const struct bt_gatt_attr *attr, const void *buf,
			      uint16_t len, uint16_t offset, uint8_t flags)
{
	static uint32_t clock_cycles;
	static uint32_t kb;

	uint64_t delta;

	struct bt_gatt_throughput_metrics *met_data = attr->user_data;

	delta = k_cycle_get_32() - clock_cycles;
	delta = k_cyc_to_ns_floor64(delta);
	LOG_DBG("Received data.");

	if (callbacks->data_received) {
		callbacks->data_received(met_data);
	}

	return len;
}

static ssize_t read_callback(struct bt_conn *conn,
			     const struct bt_gatt_attr *attr, void *buf,
			     uint16_t len, uint16_t offset)
{
	const struct bt_gatt_throughput_metrics *metrics = attr->user_data;

	len = MIN(sizeof(struct bt_gatt_throughput_metrics), len);

	if (callbacks->data_send) {
		callbacks->data_send(metrics);
	}

	LOG_DBG("Data send.");

	return bt_gatt_attr_read(
		conn, attr, buf, len, offset, attr->user_data, len);
}


BT_GATT_SERVICE_DEFINE(throughput_svc,
		BT_GATT_PRIMARY_SERVICE(BT_UUID_THROUGHPUT),
		BT_GATT_CHARACTERISTIC(BT_UUID_THROUGHPUT_CHAR,
			BT_GATT_CHRC_READ | BT_GATT_CHRC_WRITE_WITHOUT_RESP,
			BT_GATT_PERM_READ | BT_GATT_PERM_WRITE,
			read_callback, write_callback, &met),
		);

int bt_gatt_throughput_init(struct bt_gatt_throughput *throughput,
			    const struct bt_gatt_throughput_cb *cb)
{
	if (!throughput || !cb) {
		return -EINVAL;
	}

	callbacks = cb;

	return 0;
}

int bt_gatt_throughput_handles_assign(struct bt_gatt_dm *dm,
				      struct bt_gatt_throughput *throughput)
{
	const struct bt_gatt_dm_attr *gatt_service_attr =
			bt_gatt_dm_service_get(dm);
	const struct bt_gatt_service_val *gatt_service =
			bt_gatt_dm_attr_service_val(gatt_service_attr);
	const struct bt_gatt_dm_attr *gatt_chrc;
	const struct bt_gatt_dm_attr *gatt_desc;

	bool flag1 = false;
	bool flag2 = false;
	for(int i = 0; i <CONFIG_BT_MAX_CONN; i ++){
		if (!bt_uuid_cmp(gatt_service->uuid, BT_UUID_THROUGHPUT)) {
			flag1 = true;	
		}
	}
	if(flag1 == false)
		return -ENOTSUP;

	LOG_DBG("Getting handles from Throughput service.");

	/* Throughput Characteristic. */
	gatt_chrc = bt_gatt_dm_char_by_uuid(dm, BT_UUID_THROUGHPUT_CHAR);
	if (!gatt_chrc) {
		LOG_ERR("Missing Throughput characteristic.");
	}

	gatt_desc = bt_gatt_dm_desc_by_uuid(dm, gatt_chrc,
					    BT_UUID_THROUGHPUT_CHAR);
	if (!gatt_desc) {
		LOG_ERR("Missing Throughput characteristic value descriptor");
		return -EINVAL;
	}
	LOG_DBG("Found handle for Throughput characteristic.");
	throughput->char_handle = gatt_desc->handle;

	/* Assign connection object. */
	throughput->conn = bt_gatt_dm_conn_get(dm);
	return 0;
}

int bt_gatt_throughput_read(struct bt_gatt_throughput *throughput)
{
	int err;

	throughput->read_params.single.handle = throughput->char_handle;
	throughput->read_params.single.offset = 0;
	throughput->read_params.handle_count = 1;
	throughput->read_params.func = read_fn;

	err = bt_gatt_read(throughput->conn, &throughput->read_params);
	if (err) {
		LOG_ERR("Characteristic read failed.");
	}

	return err;
}

int bt_gatt_throughput_write(struct bt_gatt_throughput *throughput,
			     const uint8_t *data, uint16_t len)
{
	return bt_gatt_write_without_response(throughput->conn,
					      throughput->char_handle,
					      data, len, false);
}
```

## src/throughput.h
```c
/*
 * Copyright (c) 2018 Nordic Semiconductor ASA
 *
 * SPDX-License-Identifier: LicenseRef-BSD-5-Clause-Nordic
 */

/**
 * @file
 * @defgroup bt_gatt_throughput BLE GATT Throughput Service API
 * @{
 * @brief API for the BLE GATT Throughput Service.
 */

#ifndef BT_GATT_THROUGHPUT_H_
#define BT_GATT_THROUGHPUT_H_

#include <bluetooth/uuid.h>
#include <bluetooth/conn.h>
#include "gatt_dm.h"

#ifdef __cplusplus
extern "C" {
#endif

/** @brief Throughput metrics. */
struct bt_gatt_throughput_metrics {

        /** Number of GATT writes received. */
	uint32_t write_count;

        /** Number of bytes received. */
	uint32_t write_len;

        /** Transfer speed in bits per second. */
	uint32_t write_rate;
};

/** @brief Throughput callback structure. */
struct bt_gatt_throughput_cb {
	/** @brief Data read callback.
	 *
	 * This function is called when data has been read from the
	 * Throughput Characteristic.
	 *
	 * @param[in] met Throughput metrics.
	 *
	 * @retval BT_GATT_ITER_CONTINUE To keep notifications enabled.
	 * @retval BT_GATT_ITER_STOP To disable notifications.
	 */
	uint8_t (*data_read)(struct bt_conn *conn, const struct bt_gatt_throughput_metrics *met);

	/** @brief Data received callback.
	 *
	 * This function is called when data has been received by the
	 * Throughput Characteristic.
	 *
	 * @param[in] met Throughput metrics.
	 */
	void (*data_received)(const struct bt_gatt_throughput_metrics *met);

	/** @brief Data send callback.
	 *
	 * This function is called when data has been sent to the
	 * Throughput Characteristic.
	 *
	 * @param[in] met Throughput metrics.
	 */
	void (*data_send)(const struct bt_gatt_throughput_metrics *met);
};

/** @brief Throughput structure. */
struct bt_gatt_throughput {
	/** Throughput Characteristic handle. */
	uint16_t char_handle;

	/** GATT read parameters for the Throughput Characteristic. */
	struct bt_gatt_read_params read_params;

	/** Throughput callback structure. */
	struct bt_gatt_throughput_cb *cb;

	/** Connection object. */
	struct bt_conn *conn;
};

/** @brief Throughput Characteristic UUID. */
//#define BT_UUID_THROUGHPUT_CHAR BT_UUID_DECLARE_16(0x1524)

/** @brief Throughput Service UUID. */
//#define BT_UUID_THROUGHPUT                                                     \
	BT_UUID_DECLARE_128(0xBB, 0x4A, 0xFF, 0x4F, 0xAD, 0x03, 0x41, 0x5D,    \
			    0xA9, 0x6C, 0x9D, 0x6C, 0xDD, 0xDA, 0x83, 0x04)

/** @brief Initialize the GATT Throughput Service.
 *
 *  @param[in] throughput Throughput Service instance.
 *  @param[in] cb Callbacks.
 *
 *  @retval 0 If the operation was successful.
 *            Otherwise, a negative error code is returned.
 */
int bt_gatt_throughput_init(struct bt_gatt_throughput *throughput,
			    const struct bt_gatt_throughput_cb *cb);

/** @brief Assign handles to the Throughput Service instance.
 *
 * This function should be called when a link with a peer has been established,
 * to associate the link to this instance of the module. This makes it
 * possible to handle several links and associate each link to a particular
 * instance of this module. The GATT attribute handles are provided by the
 * GATT Discovery Manager.
 *
 * @param[in] dm Discovery object.
 * @param[in,out] throughput Throughput Service instance.
 *
 * @retval 0 If the operation was successful.
 *           Otherwise, a negative error code is returned.
 * @retval (-ENOTSUP) Special error code used when the UUID
 *         of the service does not match the expected UUID.
 */
int bt_gatt_throughput_handles_assign(struct bt_gatt_dm *dm,
				      struct bt_gatt_throughput *throughput);

/** @brief Read data from the server.
 *
 *  @note This procedure is asynchronous.
 *
 *  @param[in] throughput Throughput Service instance.
 *
 *  @retval 0 If the operation was successful.
 *            Otherwise, a negative error code is returned.
 */
int bt_gatt_throughput_read(struct bt_gatt_throughput *throughput);

/** @brief Write data to the server.
 *
 *  @param[in] throughput Throughput Service instance.
 *  @param[in] data Data.
 *  @param[in] len Data length.
 *
 *  @retval 0 If the operation was successful.
 *            Otherwise, a negative error code is returned.
 */
int bt_gatt_throughput_write(struct bt_gatt_throughput *throughput,
			     const uint8_t *data, uint16_t len);

#ifdef __cplusplus
}
#endif

/**
 * @}
 */

#endif /* BT_GATT_THROUGHPUT_H_ */
```
